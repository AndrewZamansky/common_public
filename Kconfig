## c/hw_drivers/arch/ARM/boards/nuc505/Kconfig.soc505.dt
```kconfig
menu "nuc505 soc configuration"

config MAX_NUMBER_OF_CLOCKS
    hex
    default 2 
    
config INITIAL_CORE_CLOCK
    hex
    default CRYSTAL_CLOCK 


#######################################
##########  clock tree  ###############

menu "clocks tree"

comment "CONFIG_DT_XTAL_CLOCK : external crystal clock"
config DT_XTAL_CLOCK
    hex
    default 1 

config DT_XTAL_CLOCK_RATE
    hex
    default CRYSTAL_CLOCK 



comment "CONFIG_DT_CORE_CLOCK : cortex m systick clock"
config DT_CORE_CLOCK
    hex
    default 2

endmenu


##########  end of  clock tree  ###############
###############################################

##################################################
##########  interrupts definitions ###############

menu "interrupts"

comment "CONFIG_DT_SV_CALL_INTERRUPT : sv call interrupt"
config DT_SV_CALL_INTERRUPT
    int
    default -5 

comment "CONFIG_DT_PEND_SV_INTERRUPT : pending sv interrupt"
config DT_PEND_SV_INTERRUPT
    int
    default -2 

comment "CONFIG_DT_CORTEX_M_SYSTICK_INTERRUPT : systick interrupt"
config DT_CORTEX_M_SYSTICK_INTERRUPT
    int
    default -1 

comment "CONFIG_DT_I2S_INTERRUPT : I2S interrupt"
config DT_I2S_INTERRUPT
    int
    default 3 

comment "CONFIG_DT_UART0_INTERRUPT : uart0 interrupt"
config DT_UART0_INTERRUPT
    int
    default 23 

comment "CONFIG_DT_UART1_INTERRUPT : uart1 interrupt"
config DT_UART1_INTERRUPT
    int
    default 24 
    
    
comment "CONFIG_DT_UART2_INTERRUPT : uart2 interrupt"
config DT_UART2_INTERRUPT
    int
    default 28 
        
endmenu


##########  end of interrupts definitions ###############
#########################################################
    


##################################################
##############  memories on soc ##################

menu "memories"

comment "sram start : 0x20000000"
config DT_SOC_RAM_START_ADDR
    hex 
    default 0x20000000

comment "sram size : 0x20000"
config DT_SOC_RAM_SIZE
    hex
    default 0x20000    

comment "flash start : 0x0"
config DT_SOC_FLASH_START_ADDR
    hex
    default 0x0

comment "flash size : 0x40000"
config DT_SOC_FLASH_SIZE
    hex
    default 0x40000   

endmenu

#############  end of memories on soc ###################
#########################################################



menuconfig DT_SYSTICK
	bool   "enable systick"
	default n
	
comment "CONFIG_DT_CORTEX_M_SYSTICK_INPUT_CLOCK : systick clock"
	depends on DT_SYSTICK
config DT_CORTEX_M_SYSTICK_INPUT_CLOCK
	int   
	default DT_CORE_CLOCK
	depends on DT_SYSTICK

comment "CONFIG_DT_CORTEX_M_SYSTICK_INTERRUPT : systick interrupt"
	depends on DT_SYSTICK




endmenu
```

## c/hw_drivers/arch/ARM/boards/poleg/Kconfig
```kconfig
config POLEG_BOARD
	def_bool y
	select INTERNAL_SRAM 
	select INTERNAL_ROM 
	select DDR 
	select EXTERNAL_FLASH 

config CORTEX_A9
	def_bool y
```

## c/hw_drivers/arch/ARM/soc/Kconfig
```kconfig
choice
	prompt "SOC"
	default GENERIC_ARM_SOC

config NUC505
	bool "nuc505"
	select PUBLIC_SOC_SELECTED
	select CORTEX_M4
	select SOC_HAS_DSP
	select INTERNAL_FLASH_EXISTS
	select INTERNAL_SRAM_EXISTS

config POLEG
	bool "poleg"
	select PUBLIC_SOC_SELECTED

config ARBEL
	bool "arbel"
	select PUBLIC_SOC_SELECTED
	select ARBEL_ADDITIONAL_OPTIONS
	select INTERNAL_SRAM_EXISTS
	select DDR_EXISTS

config STM32F103XXX
	bool "stm32f103xxx"
	select PUBLIC_SOC_SELECTED
	select STM32F103XXX_ADDITIONAL_OPTIONS
	select INTERNAL_FLASH_EXISTS
	select INTERNAL_SRAM_EXISTS
	select STM32F10X

config I94XXX
	bool "I94XXX"
	select PUBLIC_SOC_SELECTED
	select CORTEX_M4
	select SOC_HAS_DSP
	select INTERNAL_FLASH_EXISTS
	select INTERNAL_SRAM_EXISTS

config I96XXX_M0
	bool "I96XXX_M0"
	select PUBLIC_SOC_SELECTED
	select CORTEX_M0
	select EXTERNAL_FLASH_EXISTS
	select INTERNAL_SRAM_EXISTS

config GENERIC_ARM_SOC
	bool "generic SOC"
	select PUBLIC_SOC_SELECTED

config PRIVATE_ARM_SOC
	bool "private SOC"

endchoice

config CORTEX_M4
    bool
    default n

config CORTEX_M3
    bool
    default n

config CORTEX_M0
    bool
    default n

config CORTEX_A9
    bool
    default n

config CORTEX_A35
    bool
    default n

config ARM_926EJ_S
    bool
    default n

config SOC_HAS_DSP
    bool
    default n


if I94XXX
source "$KCONFIG_PUBLIC_START_DIR/hw_drivers/arch/ARM/soc/i94xxx/Kconfig"
endif

if I96XXX_M0
source "$KCONFIG_PUBLIC_START_DIR/hw_drivers/arch/ARM/soc/i96xxx_M0/Kconfig"
endif

if STM32F103XXX
source "$KCONFIG_PUBLIC_START_DIR/hw_drivers/arch/ARM/soc/stm32/stm32f103xxx/Kconfig"
config STM32F10X
	def_bool n
endif

if NUC505
source "$KCONFIG_PUBLIC_START_DIR/hw_drivers/arch/ARM/soc/nuc505/Kconfig"
endif

if POLEG
source "$KCONFIG_PUBLIC_START_DIR/hw_drivers/arch/ARM/soc/poleg/Kconfig"
endif

if ARBEL
source "$KCONFIG_PUBLIC_START_DIR/hw_drivers/arch/ARM/soc/arbel/Kconfig"
endif

if GENERIC_ARM_SOC
source "$KCONFIG_PUBLIC_START_DIR/hw_drivers/arch/ARM/soc/generic_board/Kconfig"
endif
```

## c/hw_drivers/arch/ARM/soc/arbel/Kconfig
```kconfig
menu "`--->  Arbel configurations"


choice
	prompt "Arbel flavors"
	default ARBEL_DEFAULT

config ARBEL_DEFAULT
	bool "arbel default"
	select ARBEL_256K_SRAM

endchoice


=======
config ARBEL_ADDITIONAL_OPTIONS
	def_bool n
	select CORTEX_A35 
	
config ARBEL_256K_SRAM
	def_bool n

endmenu

	
```

## c/hw_drivers/arch/ARM/soc/generic_board/Kconfig
```kconfig
menu "`--->  generic basic configurations"

choice
	prompt "Cpu Type"
	default CPU_UNDEFINED

config GENERIC_CORTEX_M3
	bool "cortex-M3"
	select CORTEX_M3

config GENERIC_CORTEX_M4
	bool "cortex-M4"
	select CORTEX_M4

config GENERIC_CORTEX_A9
    bool "cortex-A9"
	select CORTEX_A9

config GENERIC_ARM_926EJ_S
	bool "arm926ej-s"
	select ARM_926EJ_S

config CPU_UNKNOWN
	bool "unknown cpu"

endchoice

config INCLUDE_FPU_IN_GENERIC_ARM_SOC
	bool "include FPU in generic ARM SOC"
	depends on GENERIC_CORTEX_M4 || GENERIC_CORTEX_A9
	default n

endmenu
```
