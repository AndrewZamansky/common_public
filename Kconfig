## Kconfig
```kconfig
#
mainmenu "uCProjects Configuration"
config KCONFIG_PUBLIC_START_DIR
	string
	option env="KCONFIG_PUBLIC_START_DIR"

config KCONFIG_PRIVATE_START_DIR
	string
	option env="KCONFIG_PRIVATE_START_DIR"

source "$KCONFIG_PUBLIC_START_DIR/Kconfig"
```

## build_tools/makefiles/Kconfig
```kconfig
menu "Build System"


##### ARM  #########
if ARM

choice
	prompt "Compiler"
	default GCC

config GCC
	bool "gcc"

config GPP
    bool "g++"

config ARMCC
	bool "armcc"

endchoice

config INCLUDE_CORTEX_M_FPU
	bool   "compile with fpu support"
	depends on CORTEX_M4
	default n


endif


##### PIC32  #########
if PIC32

choice
	prompt "Compiler"
	default PIC_C32

config PIC_C32
	bool "C32 "

config PIC_XC32
	bool "XC32 "

endchoice


endif


##### STM8  #########
if STM8

choice
	prompt "Compiler"
	default CXSTM8

config CXSTM8
	bool "cosmic compiler for stm8 "

endchoice


endif


##### XTENSA  #########
if XTENSA

choice
	prompt "Compiler"
	default XTENSA_GCC

config XTENSA_GCC
	bool "gcc "

config XTENSA_XCC
	bool "xcc "

endchoice

endif


##### HEXAGON  #########
if HEXAGON

config HEXAGON_COMPILER
	def_bool  y

endif


##### ANDROID_NDK  #########
if ANDROID_NDK

config ANDROID_NDK_COMPILER
	def_bool  y

endif




##### HOST  #########
if HOST

choice
	prompt "Compiler for windows host"
	default MIN_GW_GCC

config MIN_GW_GCC
	bool "MinGW gcc"

config MIN_GW_GPP
    bool "MinGW g++"

config MICROSOFT_COMPILER
    bool "Microsoft Compiler"


endchoice

choice
	prompt "Compiler for linux host"
	default LINUX_HOST_GCC

config LINUX_HOST_GCC
	bool "gcc"

config LINUX_HOST_GPP
    bool "g++"

endchoice

endif


choice
	prompt "output type"
	default OUTPUT_TYPE_APPLICATION

config OUTPUT_TYPE_APPLICATION
	bool "application"

config OUTPUT_TYPE_STATIC_LIBRARY
	depends on XTENSA_XCC
	bool "static library"

config OUTPUT_TYPE_DYNAMIC_LIBRARY
	depends on HEXAGON_COMPILER || ANDROID_NDK_COMPILER || MICROSOFT_COMPILER
	bool "dynamic library"
endchoice


if GCC || GPP || MIN_GW_GCC || MIN_GW_GPP || PIC_C32 || PIC_XC32 || ANDROID_NDK_COMPILER || XTENSA_GCC
source "$KCONFIG_PUBLIC_START_DIR/../build_tools/makefiles/c/compilers/gcc/Kconfig"
endif

if MICROSOFT_COMPILER
source "$KCONFIG_PUBLIC_START_DIR/../build_tools/makefiles/c/compilers/microsoft_compiler/Kconfig"
endif


if HEXAGON_COMPILER
source "$KCONFIG_PUBLIC_START_DIR/../build_tools/makefiles/c/compilers/clang/Kconfig"
endif

if XTENSA_XCC
source "$KCONFIG_PUBLIC_START_DIR/../build_tools/makefiles/c/compilers/xcc/Kconfig"
endif

menuconfig INCLUDE_TOOLCHAIN_LIBRARIES
	bool   "tool chain libraries"
	default y
	
config TOOLCHAIN_LIBRARIES_ARE_SPEED_CRUCIAL
	bool   "tool chain libraries are speed crucial"
	depends on INCLUDE_TOOLCHAIN_LIBRARIES
	default n

config COMPILE_FOR_DEBUG
	bool   "compile for debugging(include debug info)"
	default y


endmenu
```

## build_tools/makefiles/c/compilers/armcc/Kconfig
```kconfig
menu "ARMCC options"

choice
	prompt "Optimisation Level"
	default ARMCC_OPTIMISE_NONE

config ARMCC_OPTIMISE_NONE
	bool "-O0 : No Optimisations"

config ARMCC_OPTIMISE_SIZE_Os
    bool "-Os : Optimise for size "

config ARMCC_OPTIMISE_SIZE_Oz
    bool "-Oz : Optimise for size more than Os"

config ARMCC_OPTIMISE_SPEED_O1
	bool "-O1 : Optimise for speed"

config ARMCC_OPTIMISE_SPEED_O2
	bool "-O2 : Optimise for speed more than -O1"

config ARMCC_OPTIMISE_SPEED_O3
	bool "-O3 : Optimise for speed more than -O2"

config ARMCC_OPTIMISE_SPEED_Ofast
	bool "-Ofast : Optimise for speed more than -O3"

config ARMCC_OPTIMISE_SPEED_Omax
	bool "-Omax : Optimise for speed more than -Ofast"


endchoice


config ARMCC_OPTIMISE_SPEED_Otime
	bool "-Otime : Optimise for speed even more"
	default n

endmenu
```

## build_tools/makefiles/c/compilers/clang/Kconfig
```kconfig
menu "clang options"

##### XTENSA  #########
if XTENSA

choice
	prompt "Tools version"
	default CLANG_TOOLS_VER_2017_7

config CLANG_TOOLS_VER_2017_6
	bool "RG-2017.6"

config CLANG_TOOLS_VER_2017_7
	bool "RG-2017.7"

config CLANG_TOOLS_VER_RI_2018_0
	bool "RI-2018.0"

config CLANG_TOOLS_VER_RI_2021_6
	bool "RI-2021.6"

config CLANG_TOOLS_VER_RI_2022_9
	bool "RI-2022.9"

config CLANG_TOOLS_VER_RI_2022_10
	bool "RI-2022.10"

endchoice


endif




choice
	prompt "Optimization Level"
	default CLANG_OPTIMIZE_NONE

config CLANG_OPTIMIZE_NONE
	bool "-O0 : No Optimizations"

config CLANG_OPTIMIZE_SIZE
    bool "-Os : Optimize for size "

config CLANG_OPTIMIZE_SPEED
	bool "-O2 : Optimize for speed "

config CLANG_OPTIMIZE_ULTRA_SPEED
	bool "-O3 : Optimize for ultra-speed but can increase code-size "

endchoice


endmenu
```

## build_tools/makefiles/c/compilers/gcc/Kconfig
```kconfig
menu "GCC options"


##### ARM  #########
if ARM

config GCC_VENDOR_NAME
    string "gcc vendor name"
    default ""

choice
	prompt "OS on target(part of gcc naming convention)"
	default GCC_TARGET_OS_NONE

config GCC_TARGET_OS_LINUX
	bool "linux"

config GCC_TARGET_OS_NONE
    bool "none"
endchoice

choice
	prompt "ABI Type"
	default EABI

config EABI
	bool "eabi(bare metal)"

config GNUEABI
    bool "gnueabi(for linux)"
endchoice



config USE_NANO_STD_LIBS
	bool   "use nano std libs to reduce code size "
	default n

config USED_FOR_SEMIHOSTING_UPLOADING
	bool   "used for semihosting uploading"
	default n

endif


##### ANDROID_NDK_COMPILER  #########
if ANDROID_NDK_COMPILER

choice
	prompt "gcc architecture"
	default ANDROID_NDK_ARCH_ARM

config ANDROID_NDK_ARCH_ARM
	bool "arm"
config ANDROID_NDK_ARCH_ARM64
	bool "aarch64"
config ANDROID_NDK_ARCH_MIPS
	bool "mips"
config ANDROID_NDK_ARCH_MIPS64
	bool "mips64"
endchoice

choice
	prompt "gcc version of ndk"
	default ANDROID_NDK_GCC_4_9

config ANDROID_NDK_GCC_4_6
	bool "4.6"
config ANDROID_NDK_GCC_4_8
	bool "4.8"
config ANDROID_NDK_GCC_4_9
	bool "4.9"
endchoice

endif


##### HOST  #########
if HOST

config MINGW_GCC_VERSION
    string "MinGW  version in form : xx.xx[.xx]"
    default "4.8.1"

endif

##### PIC32  #########
if PIC32

choice
	prompt "compiler location"
	default PIC32_COMPILER_LOCATION_WINDOWS_DEFAULT

config PIC32_COMPILER_LOCATION_WINDOWS_DEFAULT
	bool "pic32 compiler located in windows default location"

config PIC32_COMPILER_LOCATION_WORKSPACE_TOOLS_DIRECTORY
    bool "pic32 compiler located in workspace tool directory"
endchoice

config PIC32_C32_VERSION
    string "PIC32 C32  version in form : xx.xx"
    depends on PIC32_COMPILER_LOCATION_WORKSPACE_TOOLS_DIRECTORY
    default "2.01"


endif


##### ANDROID_NDK_COMPILER  #########
if ANDROID_NDK_COMPILER

endif


##### XTENSA  #########
if XTENSA
endif


choice
	prompt "Optimisation Level"
	default GCC_OPTIMISE_NONE

config GCC_OPTIMISE_NONE
	bool "-O0 : No Optimisations"

config GCC_OPTIMISE_WITH_DEBUG
	bool "-Og  : Optimise without loss in debug info "
	depends on GCC || GPP

config GCC_OPTIMISE_SIZE
    bool "-Os : Optimise for size "

config GCC_OPTIMISE_SPEED
	bool "-O2 : Optimise for speed "

config GCC_OPTIMISE_ULTRA_SPEED
	bool "-O3 : Optimise for ultra-speed but can increase code-size "

endchoice



endmenu
```

## build_tools/makefiles/c/compilers/microsoft_compiler/Kconfig
```kconfig
menu "Microsoft compiler options"

if OUTPUT_TYPE_APPLICATION && (!JUCE_VST_PLUGIN)

choice
	prompt "output type"
	default MSVC_OUTPUT_TYPE_CONSOLE_APPLICATION

config MSVC_OUTPUT_TYPE_WINDOWS_APPLICATION
	bool "windows application"

config MSVC_OUTPUT_TYPE_CONSOLE_APPLICATION
	bool "console application"

endchoice

endif ## from "if OUTPUT_TYPE_APPLICATION"


choice
	prompt "compiler location"
	default MSVC_COMPILER_LOCATION_WINDOWS_DEFAULT

config MSVC_COMPILER_LOCATION_WINDOWS_DEFAULT
	bool "microsoft compiler located in windows default location"

config MSVC_COMPILER_LOCATION_WORKSPACE_TOOLS_DIRECTORY
    bool "microsoft compiler located in workspace tool directory"
endchoice



choice
	prompt "compiler arch"
	default MSC_TARGET_ARCH_X86

config MSC_TARGET_ARCH_X86
	bool "x86_32"

config MSC_TARGET_ARCH_X64
	bool "x86_64"
endchoice

 
choice
	prompt "Optimisation Level"
	default MSVC_OPTIMISE_NONE

config MSVC_OPTIMISE_NONE
	bool "/Od : No Optimisations (Debug)"

config MSVC_OPTIMISE_SIZE
    bool "/O1 : Optimise for size "

config MSVC_OPTIMISE_SPEED
	bool "/O2 : Optimise for speed "

config MSVC_OPTIMISE_FULL
	bool "/Ox : full optimization "

endchoice

choice
	prompt "crt libraries usage"
	default MSVC_CRT_LIBRARIES_LINKED_DINAMICALLY

config MSVC_CRT_LIBRARIES_LINKED_DINAMICALLY
	bool "crt libraries linked dynamically /MD"

config MSVC_CRT_LIBRARIES_LINKED_STATICALLY
	bool "crt libraries linked statically /MT"
endchoice

config USE_WINDOWS_KITS
    bool "use windows kit (WDK)"
    default y


menuconfig MSVC_IGNORE_DEFAULT_LIBRARIES
    bool "ignore default libraries"

config MSVC_IGNORE_ALL_DEFAULT_LIBRARIES
    bool "ignore all default libraries"
    depends on MSVC_IGNORE_DEFAULT_LIBRARIES

config MSVC_IGNORE_LIBCMT_LIBRARY
    bool "ignore libcmt.lib"
    depends on MSVC_IGNORE_DEFAULT_LIBRARIES && !MSVC_IGNORE_ALL_DEFAULT_LIBRARIES

config MSVC_IGNORE_MSVCRT_LIBRARY
    bool "ignore msvcrt.lib"
    depends on MSVC_IGNORE_DEFAULT_LIBRARIES && !MSVC_IGNORE_ALL_DEFAULT_LIBRARIES

endmenu
```

## build_tools/makefiles/c/compilers/xcc/Kconfig
```kconfig
menu "XCC options"

choice
	prompt "Tools version"
	default XCC_TOOLS_VER_2017_7

config XCC_TOOLS_VER_2017_6
	bool "RG-2017.6"

config XCC_TOOLS_VER_2017_7
	bool "RG-2017.7"

config XCC_TOOLS_VER_RI_2018_0
	bool "RI-2018.0"

endchoice




menu "Optimizations"

choice
	prompt "Optimization Level"
	default GCC_OPTIMIZE_NONE

config XCC_OPTIMIZE_NONE
	bool "-O0 : No Optimizations"

config XCC_OPTIMISE_WITH_DEBUG
	bool "-Og : Optimizations with debugging support"

config XCC_OPTIMIZE_SIZE
    bool "-Os : Optimize for size "

config XCC_OPTIMIZE_SPEED_SLIGHTLY
	bool "-O1 : Optimize for speed slightly "

config XCC_OPTIMIZE_SPEED
	bool "-O2 : Optimize for speed "

config XCC_OPTIMIZE_ULTRA_SPEED
	bool "-O3 : Optimize for ultra-speed but can increase code-size "

endchoice

config XCC_OPT_KEEP_INTERMEDIATE
	bool "Keep intermediate files generated by the compiler"
	default n
	---help---
		[-save-temps] Saves intermediate files generated by the compiler;
		by default, they are discarded.
		
config XCC_OPT_INTER_PROCEDURAL_ANALYSIS
	bool "Perform inter-procedural analysis"
	default n
	---help---
		[-ipa] Perform inter-procedural analysis and optimization.
		If any file is compiled with IPA (-c -ipa), the .o files will be
		linked with the -ipa option and will be linked with xt-xc++
		for building the executable.

config XCC_OPT_USE_DSP_COPROCESSOR
	bool "Use DSP co-processor"
	default n
	---help---
		[-mcoproc] Allow use of coprocessor register files. Higher
		performance but perhaps not safe when compiling interrupt handlers.

config XCC_OPT_DONT_GENERATE_MEMW_INSTRUCTIONS
	bool "Do not serialize volatile memory access"
	default n
	---help---
		[-mno-serialize-volatile] Do not generate MEMW instructions
		in between volatile memory references.

config XCC_OPT_PUT_LITERALS_IN_TEXT_SECTION
	bool "Put literals in text section"
	default n
	---help---
		[-mtext-section-literals] Generates literals interspersed in the text
		section in order to keep them as close as possible to their references.

#config XCC_OPT_GENERATE_A_DYNAMIC_CALL_GRAPH
#	bool "Enable a dynamic callgraph data collection"
#	default n
#	---help---
#		Compiling with this option instruments every call to generate a dynamic
#		call graph allowing the profiler to estimate hierarchical
#		profiles but also perturbing the executable.

config XCC_OPT_FEEDBACK_INFO_TO_REORDER_FUNCTIONS
	bool "Uses feedback info to reorder functions"
	default n
	---help---
		[-fb_reorder] Uses feedback info to reorder
		functions for better cache utilization.

config XCC_OPT_OPTIMIZES_FOR_SPACE
	bool "Optimizes for space"
	default n
	---help---
		[-Os] Optimizes for space. This option can be used in conjunction with
		any optimization level, but the optimizations are guided
		by the goal of minimizing the code size.

config XCC_OPT_ENABLE_OPTIMIZATION_ALIAS_RESTRICT
	bool "Enable optimization alias restrict"
	default n
	---help---
		[-OPT:alias=restrict] The compiler assumes that memory references with
		one level of indirection through different named pointers do not alias
		with each other, nor with any direct memory references.

config XCC_OPT_ENABLE_AUTOMATIC_VECTORIZATION
	bool "Enable automatic vectorization"
	default n
	---help---
		[-LNO:simd] Enables vectorization. This option is only valid in
		conjunction with the -O3 option.
		Choosing this option also adds "-LNO:simd_v" to compile line.

config XCC_OPT_SPECULATIVELY_VECTORIZING_LOOPS_WITH_IFS
	bool "Speculatively vectorizing loops with ifs"
	default n
	---help---
		[-LNO:simd_agg_if_conv] Vectorizes a loop containing an IF statement
		even if vectorizing the statement might cause the system to load
		a value that otherwise would not have been loaded.

config XCC_OPT_ASSUME_PARAMETERS_ARE_ALIGNED
	bool "Assume parameters are aligned"
	default n
	---help---
		[-LNO:aligned_formal_pointers=on] Treats all pointers passed as formal
		parameters to functions as if they are aligned
		correctly for use in the vectorizer.

config XCC_OPT_OPTIMIZE_FOR_CONNECTION_BOX
	bool "Optimize for connection box"
	default n
	---help---
		[-mcbox] Compile code for processors with 2 load/stores to avoid
		issuing 2 loads to the same memory in the same cycle.
		Often used in conjunction with memory placement pragmas to inform the
		compiler of the memory accessed by a given pointer in a program.

config XCC_OPT_PRODUCE_W2C_FILE
	bool "Produce w2c file"
	default n
	---help---
		[-clist] Produces a .w2c.c file that contains a C-level view of code
		transformations performed by XCC.
		This option is not applicable to C++ input files.

config XCC_OPT_ENABLE_LONG_CALLS
	bool "Enable long calls"
	default n
	---help---
		[-mlongcalls] Enables transformation of direct calls into indirect
		calls to allow calls across a greater address range.

config XCC_OPT_CREATE_SEPARATE_FUNCTION_SECTIONS
	bool "Create separate function sections"
	default y
	---help---
		[-ffunction-sections] Creates a separate section for each function to
		improve cache performance.
		See Update Link Order on the Project context menu.

endmenu #Optimization manu

endmenu
```

## c/Kconfig
```kconfig
#

config PROJECT_NAME
	string "Project Name"
	default ""

menuconfig PROJECT_IS_PART_OF_BUNDLE
	bool "this project is part of bundle"
	default n

config NAME_SUFFIX_IN_BUNDLE
	string "Project Name Suffix"
	depends on PROJECT_IS_PART_OF_BUNDLE
	default ""

menuconfig OUTPUT_NAME_CHOOSEN_AUTOMATICALLY
	bool "name of final output is choosen automatically"
	default y

config REDEFINED_OUTPUT_NAME
	string "name of final output"
	depends on !OUTPUT_NAME_CHOOSEN_AUTOMATICALLY
	default "out"

choice
	prompt "Architecture"
	default HOST

config ARM
	bool "arm"

config PIC32
	bool "pic32"

config STM8
	bool "stm8"

config AVR
	bool "avr"

config XTENSA
	bool "xtensa"

config HEXAGON
	bool "hexagon"

config ANDROID_NDK
	bool "android_ndk"

config HOST
	bool "host"

endchoice


source "$KCONFIG_PUBLIC_START_DIR/../build_tools/makefiles/Kconfig"
	   	
if !HOST
source "$KCONFIG_PUBLIC_START_DIR/hw_drivers/arch/Kconfig"
endif

menu "Hardware Drivers"
source "$KCONFIG_PUBLIC_START_DIR/hw_drivers/Kconfig"
endmenu


menu "Software Packages"
source "$KCONFIG_PUBLIC_START_DIR/sw_packages/Kconfig"
endmenu

menuconfig USE_COMMON_PRIVATE_PACKAGES
	bool   "use common private packages"
	default n

if 	USE_COMMON_PRIVATE_PACKAGES
source "$KCONFIG_PRIVATE_START_DIR/Kconfig"
config COMMON_PRIVATE_GIT_COMMIT_HASH
	string "common private git commit hash"
	default ""
endif


config CPU_CALCULATE_CRC32
	bool   "calculate crc32 of output binary"
	default n

config COMMON_PUBLIC_GIT_COMMIT_HASH
	string "common public git commit hash"
	default ""
```
