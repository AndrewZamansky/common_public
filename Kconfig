## c/build_tools/makefiles/Kconfig
```kconfig
menu "Build System"


##### ARM  #########
if ARM

choice
	prompt "Compiler"
	default GCC

config GCC
	bool "gcc"

config GPP
    bool "g++"

config ARMCC
	bool "armcc"

endchoice

config INCLUDE_CORTEX_M_FPU
	bool   "compile with fpu support"
	depends on CORTEX_M4
	default n


endif


##### PIC32  #########
if PIC32

choice
	prompt "Compiler"
	default PIC_C32

config PIC_C32
	bool "C32 "

config PIC_XC32
	bool "XC32 "

endchoice


endif


##### STM8  #########
if STM8

choice
	prompt "Compiler"
	default CXSTM8

config CXSTM8
	bool "cosmic compiler for stm8 "

endchoice


endif


##### HEXAGON  #########
if HEXAGON

config HEXAGON_COMPILER
	def_bool  y

endif


##### ANDROID_NDK  #########
if ANDROID_NDK

config ANDROID_NDK_COMPILER
	def_bool  y

endif




##### HOST  #########
if HOST

choice
	prompt "Compiler for windows host"
	default MIN_GW_GCC

config MIN_GW_GCC
	bool "MinGW gcc"

config MIN_GW_GPP
    bool "MinGW g++"

config MICROSOFT_COMPILER
    bool "Microsoft Compiler"


endchoice

choice
	prompt "Compiler for linux host"
	default LINUX_HOST_GCC

config LINUX_HOST_GCC
	bool "gcc"

config LINUX_HOST_GPP
    bool "g++"

endchoice

endif


if GCC || GPP || MIN_GW_GCC || MIN_GW_GPP || PIC_C32 || PIC_XC32 || ANDROID_NDK_COMPILER
source "$COMMON_DIR_PATH/c/build_tools/makefiles/gcc/Kconfig"
endif

if MICROSOFT_COMPILER
source "$COMMON_DIR_PATH/c/build_tools/makefiles/microsoft_compiler/Kconfig"
endif


if HEXAGON_COMPILER
source "$COMMON_DIR_PATH/c/build_tools/makefiles/clang/Kconfig"
endif


menuconfig INCLUDE_TOOLCHAIN_LIBRARIES
	bool   "tool chain libraries"
	default y
	
config TOOLCHAIN_LIBRARIES_ARE_SPEED_CRUCIAL
	bool   "tool chain libraries are speed crucial"
	depends on INCLUDE_TOOLCHAIN_LIBRARIES
	default n

config COMPILE_FOR_DEBUG
	bool   "compile for debugging(include debug info)"
	default y


endmenu
```

## c/build_tools/makefiles/clang/Kconfig
```kconfig
menu "clang options"

choice
	prompt "output type"
	default CLANG_OUTPUT_TYPE_APPLICATION

config CLANG_OUTPUT_TYPE_APPLICATION
	bool "application"

config CLANG_OUTPUT_TYPE_DYNAMIC_LIBRARY
	bool "dynamic library"
endchoice


choice
	prompt "Optimization Level"
	default GCC_OPTIMIZE_NONE

config GCC_OPTIMIZE_NONE
	bool "-O0 : No Optimizations"

config GCC_OPTIMIZE_SIZE
    bool "-Os : Optimize for size "

config GCC_OPTIMIZE_SPEED
	bool "-O2 : Optimize for speed "

config GCC_OPTIMIZE_ULTRA_SPEED
	bool "-O3 : Optimize for ultra-speed but can increase code-size "

endchoice


endmenu
```

## c/build_tools/makefiles/gcc/Kconfig
```kconfig
menu "GCC options"



##### ARM  #########
if ARM

config ARM_GCC_VERSION
    string "gcc version in form : xx.xx[.xx]"
    default "4.9.3"


config GCC_VENDOR_NAME
    string "gcc vendor name"
    default ""

choice
	prompt "OS on target(part of gcc naming convention)"
	default GCC_TARGET_OS_NONE

config GCC_TARGET_OS_LINUX
	bool "linux"

config GCC_TARGET_OS_NONE
    bool "none"
endchoice

choice
	prompt "ABI Type"
	default EABI

config EABI
	bool "eabi"

config GNUEABI
    bool "gnueabi"
endchoice



config USE_NANO_STD_LIBS
	bool   "use nano std libs to reduce code size "
	default n

config USED_FOR_SEMIHOSTING_UPLOADING
	bool   "used for semihosting uploading"
	default n

endif

##### HOST  #########
if HOST

config MINGW_GCC_VERSION
    string "MinGW  version in form : xx.xx[.xx]"
    default "4.8.1"

endif

##### PIC32  #########
if PIC32

choice
	prompt "compiler location"
	default PIC32_COMPILER_LOCATION_WINDOWS_DEFAULT

config PIC32_COMPILER_LOCATION_WINDOWS_DEFAULT
	bool "pic32 compiler located in windows default location"

config PIC32_COMPILER_LOCATION_WORKSPACE_TOOLS_DIRECTORY
    bool "pic32 compiler located in workspace tool directory"
endchoice

config PIC32_C32_VERSION
    string "PIC32 C32  version in form : xx.xx"
    depends on PIC32_COMPILER_LOCATION_WORKSPACE_TOOLS_DIRECTORY
    default "2.01"


endif



choice
	prompt "Optimisation Level"
	default GCC_OPTIMISE_NONE

config GCC_OPTIMISE_NONE
	bool "-O0 : No Optimisations"

config GCC_OPTIMISE_WITH_DEBUG
	bool "-Og  : Optimise without loss in debug info "
	depends on GCC || GPP

config GCC_OPTIMISE_SIZE
    bool "-Os : Optimise for size "

config GCC_OPTIMISE_SPEED
	bool "-O2 : Optimise for speed "

config GCC_OPTIMISE_ULTRA_SPEED
	bool "-O3 : Optimise for ultra-speed but can increase code-size "

endchoice




endmenu
```

## c/build_tools/makefiles/microsoft_compiler/Kconfig
```kconfig
menu "Microsoft compiler options"

choice
	prompt "output type"
	default MSVC_OUTPUT_TYPE_CONSOLE_APPLICATION

config MSVC_OUTPUT_TYPE_WINDOWS_APPLICATION
	depends on !JUCE_VST_PLUGIN
	bool "windows application"

config MSVC_OUTPUT_TYPE_CONSOLE_APPLICATION
	depends on !JUCE_VST_PLUGIN
	bool "console application"

config MSVC_OUTPUT_TYPE_DLL
	bool "dll"
endchoice


choice
	prompt "compiler location"
	default MSVC_COMPILER_LOCATION_WINDOWS_DEFAULT

config MSVC_COMPILER_LOCATION_WINDOWS_DEFAULT
	bool "microsoft compiler located in windows default location"

config MSVC_COMPILER_LOCATION_WORKSPACE_TOOLS_DIRECTORY
    bool "microsoft compiler located in workspace tool directory"
endchoice



choice
	prompt "compiler arch"
	default MSVC_COMPILER_32

config MSVC_COMPILER_32
	bool "x86_32"

config MSVC_COMPILER_64
	bool "x86_64"
endchoice

 
choice
	prompt "Optimisation Level"
	default MSVC_OPTIMISE_NONE

config MSVC_OPTIMISE_NONE
	bool "/Od : No Optimisations (Debug)"

config MSVC_OPTIMISE_SIZE
    bool "/O1 : Optimise for size "

config MSVC_OPTIMISE_SPEED
	bool "/O2 : Optimise for speed "

config MSVC_OPTIMISE_FULL
	bool "/Ox : full optimization "

endchoice

choice
	prompt "crt libraries usage"
	default MSVC_CRT_LIBRARIES_LINKED_DINAMICALLY

config MSVC_CRT_LIBRARIES_LINKED_DINAMICALLY
	bool "crt libraries linked dynamically /MD"

config MSVC_CRT_LIBRARIES_LINKED_STATICALLY
	bool "crt libraries linked statically /MT"
endchoice

config USE_WINDOWS_KITS
    bool "use windows kit (WDK)"
    default y


menuconfig MSVC_IGNORE_DEFAULT_LIBRARIES
    bool "ignore default libraries"

config MSVC_IGNORE_ALL_DEFAULT_LIBRARIES
    bool "ignore all default libraries"
    depends on MSVC_IGNORE_DEFAULT_LIBRARIES

config MSVC_IGNORE_LIBCMT_LIBRARY
    bool "ignore libcmt.lib"
    depends on MSVC_IGNORE_DEFAULT_LIBRARIES && !MSVC_IGNORE_ALL_DEFAULT_LIBRARIES

config MSVC_IGNORE_MSVCRT_LIBRARY
    bool "ignore msvcrt.lib"
    depends on MSVC_IGNORE_DEFAULT_LIBRARIES && !MSVC_IGNORE_ALL_DEFAULT_LIBRARIES

endmenu
```

## c/hw_drivers/I2S/I2S_nuc505/Kconfig
```kconfig
#
	

config  I2S_NUC505_USE_EXTERNAL_CODEC
	bool   "use external codec"
	default 0

config  I2S_NUC505_USE_SAMPLE_RATE_DETECTION
	bool   "use sample rate detection"
	default 0
```

## c/hw_drivers/I2S/Kconfig
```kconfig
#
	
if NUC505
source "$KCONFIG_PUBLIC_START_DIR/hw_drivers/I2S/I2S_nuc505/Kconfig"
endif

config INTERNAL_I2S_SPEED_CRITICAL
	bool   "internal i2s is speed critical"
	depends on INCLUDE_INTERNAL_I2S
	default y
```

## c/hw_drivers/Kconfig
```kconfig
#

config INCLUDE_INTERNAL_CLOCK_CONTROL
	bool   "internal clock control"
	depends on NUC505 || STM32F10X || NPCE586 || I94XXX || XTENSA_SIM || XTENSA_FPGA_SIM
	default n

config INCLUDE_CORTEXM_SYSTICK
	bool   "cortex-m systick"
	depends on CORTEX_M3 || CORTEX_M4
	default n

config INCLUDE_NVIC
	bool   "nvic"
	depends on CORTEX_M3 || CORTEX_M4
	default n

config INCLUDE_GIC
	bool   "gic"
	depends on CORTEX_A9
	default n

######## semihosting configurations #########
menuconfig INCLUDE_SEMIHOSTING
	bool   "semihosting"
	depends on ARM || XTENSA_XCC
	select INCLUDE_PRINTF
	default n
if INCLUDE_SEMIHOSTING
config ARM_SEMIHOSTING_CONFIG_ENABLE_RX
	bool   "enable rx of semihosting"
	depends on CORTEX_M3 || CORTEX_M4 || CORTEX_A9
	select INCLUDE_PRINTF
	default n

config ARM_SEMIHOSTING_RX_BUFFER
	int   "semihostint rx buffer size"
	depends on ARM_SEMIHOSTING_CONFIG_ENABLE_RX
	default 32

endif
######## end of semihosting configurations #########	

config INCLUDE_INTERNAL_UART
	bool   "internal uart"
	depends on NUC505 || STM32F103RC || NPCE586 || STM8S103F || I94XXX
	default n

config INCLUDE_LINUX_UART
	bool   "linux uart"
	depends on HOST
	default n

config INCLUDE_INTERNAL_I2C
	bool   "internal i2c"
	depends on I94XXX
	default n

config INCLUDE_INTERNAL_SPI
	bool   "internal spi"
	depends on STM32F103RC || STM8S103F || I94XXX
	default n

config INCLUDE_INTERNAL_ADC
	bool   "internal adc"
	depends on STM32F103RC || STM8S103F
	default n

config INCLUDE_INTERNAL_TIMER
	bool   "internal timer"
	depends on NUC505 || STM32F103RC || NPCE586 || STM8S103F || XTENSA_SIM || XTENSA_FPGA_SIM
	default n

config INCLUDE_INTERNAL_FLASH
	bool   "internal flash"
	depends on STM32F10x || I94XXX
	default n

config INCLUDE_INTERNAL_GPIO
	bool   "internal gpio"
	depends on NUC505 || STM32F103RC || NPCE586 || STM8S103F || PIC32MX575 || I94XXX
	default n


menuconfig INCLUDE_INTERNAL_DMA
	bool   "internal dma"
	depends on I94XXX
	default n
	
config INCLUDE_INTERNAL_SERIAL_NUMBER
	bool   "internal serial number"
	depends on STM32F10x
	default n
	
menuconfig INCLUDE_INTERNAL_I2S
	bool   "internal i2s"
	depends on NUC505 || I94XXX
	default n
	
if INCLUDE_INTERNAL_I2S
source "$KCONFIG_PUBLIC_START_DIR/hw_drivers/I2S/Kconfig"
endif


menuconfig INCLUDE_INTERNAL_PWM
	bool   "internal pwm"
	depends on I94XXX
	default n

config INTERNAL_PWM_IS_SPEED_CRITICAL
	bool   "internal pwm is speed critical"
	depends on INCLUDE_INTERNAL_PWM
	default n


config INCLUDE_INTERNAL_USB_DEVICE
	bool   "internal usb device"
	depends on STM32F103RC || STM8S103F || I94XXX
	default n


config INCLUDE_USB_VIRTUAL_COM
	bool   "usb virtual com"
	depends on STM32F10x
	default n
	
config INCLUDE_ESP8266
	bool   "ESP8266"
	default n

	
config INCLUDE_USB_MASS_STORAGE
	bool   "usb mass storage"
	depends on STM32F10x
	default n


config INCLUDE_LM35
	bool   "lm35 thermal sensor"
	default n

config INCLUDE_INTERNAL_ADC
	bool   "internal adc"
	depends on STM32F10x
	default n

config INCLUDE_GPIO_REMOTE
	bool   "remote gpio"
	default n

config INCLUDE_WIRELESS_UART
	bool   "wireless uart"
	default n

source "$KCONFIG_PUBLIC_START_DIR/hw_drivers/storage/Kconfig"
source "$KCONFIG_PUBLIC_START_DIR/hw_drivers/audio_codecs/Kconfig"

######## automatically selected configurations #########
config INCLUDE_SERIAL_NUMBER
	def_bool  y
	depends on INCLUDE_INTERNAL_SERIAL_NUMBER

config INCLUDE_CLOCK_CONTROL
	def_bool  y
	depends on INCLUDE_INTERNAL_CLOCK_CONTROL

config INCLUDE_UART
	def_bool  y
	depends on (CONFIG_INCLUDE_SEMIHOSTING || INCLUDE_INTERNAL_UART || \
		INCLUDE_USB_VIRTUAL_COM  || INCLUDE_SEMIHOSTING || INCLUDE_LINUX_UART)

config INCLUDE_USB_DEVICE
	def_bool  y
	depends on INCLUDE_INTERNAL_USB_DEVICE

config INCLUDE_I2C
	def_bool  y
	depends on INCLUDE_INTERNAL_I2C

config INCLUDE_ADC
	def_bool  y
	depends on INCLUDE_INTERNAL_ADC

config INCLUDE_HW_TIMER
	def_bool  y
	depends on INCLUDE_CORTEXM_SYSTICK || INCLUDE_INTERNAL_TIMER || XTENSA

config INCLUDE_GPIO
	def_bool  y
	depends on INCLUDE_INTERNAL_GPIO 

config INCLUDE_FLASH_WRAPPER
	def_bool  y
	depends on INCLUDE_INTERNAL_FLASH

######## end of automatically selected configurations #########	
```

## c/hw_drivers/arch/ARM/Kconfig
```kconfig
choice
	prompt "Compiler"
	default GCC

config GCC
	bool "gcc"

config GPP
    bool "g++"

config ARMCC
	bool "armcc"

endchoice


if GCC || GPP
source "$COMMON_DIR_PATH/c/build_tools/makefiles/gcc/Kconfig"
endif

menuconfig INCLUDE_TOOLCHAIN_LIBRARIES
	bool   "tool chain libraries"
	default y
	
config TOOLCHAIN_LIBRARIES_ARE_SPEED_CRUCIAL
	bool   "tool chain libraries are speed crucial"
	depends on INCLUDE_TOOLCHAIN_LIBRARIES
	default n	




    
config INCLUDE_FPU
	bool   "fpu"
	depends on CORTEX_M4
	default n

choice
	prompt "Optimisation Level"
	default OPTIMISE_NONE

config OPTIMISE_NONE
	bool "-O0 : No Optimisations"

config OPTIMISE_WITH_DEBUG
	bool "-Og  : Optimise without loss in debug info "
	depends on GCC || GPP

config OPTIMISE_SIZE
    bool "-Os : Optimise for size "

config OPTIMISE_SPEED
	bool "-O2 : Optimise for speed "

config OPTIMISE_ULTRA_SPEED
	bool "-O3 : Optimise for ultra-speed but can increase code-size "

endchoice


config USED_FOR_SEMIHOSTING_UPLOADING
	bool   "used for semihosting uploading"
	default n
```

## c/hw_drivers/arch/ARM/boards/Kconfig
```kconfig
choice
	prompt "SOC"
	default GENERIC_SOC

config NUC505
	bool "nuc505"

config POLEG
	bool "poleg"

config STM32F10x
	bool "stm32f10x"

config GENERIC_SOC
	bool "generic SOC"

endchoice

config CORTEX_M4
    bool
    default n

config CORTEX_M3
    bool
    default n

config CORTEX_A9
    bool
    default n

config ARM_926EJ_S
    bool
    default n

if NUC505
source "$COMMON_DIR_PATH/c/hw_drivers/arch/ARM/boards/nuc505/Kconfig"
endif

if POLEG
source "$COMMON_DIR_PATH/c/hw_drivers/arch/ARM/boards/poleg/Kconfig"
endif

if GENERIC_SOC
source "$COMMON_DIR_PATH/c/hw_drivers/arch/ARM/boards/generic_board/Kconfig"
endif
```

## c/hw_drivers/arch/ARM/boards/nuc505/Kconfig
```kconfig
menu "`--->  nuc505 board configurations"

choice
	prompt "Board"
	default NUC505_EB

config NUC505_EB
	bool "nuc505 evaluation board"

endchoice

if NUC505_EB
source "$COMMON_DIR_PATH/c/hw_drivers/arch/ARM/boards/nuc505/Kconfig.eb505.dt"
endif



endmenu

=======
config NUC505_BOARD
	def_bool y
	select INTERNAL_SRAM 
	select INTERNAL_FLASH 
	
config CORTEX_M4
	def_bool y
```

## c/hw_drivers/arch/ARM/boards/nuc505/Kconfig.eb505.dt
```kconfig
menu "`---> nuc505 evaluation board"


config CRYSTAL_CLOCK
    hex "crystal clock in Hz"
    default 12000000 
    
    
source "$COMMON_DIR_PATH/c/hw_drivers/arch/ARM/boards/nuc505/Kconfig.soc505.dt"


endmenu
```
