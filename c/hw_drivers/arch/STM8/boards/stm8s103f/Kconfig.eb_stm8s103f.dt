## c/hw_drivers/arch/STM8/boards/stm8s103f/Kconfig.eb_stm8s103f.dt
```kconfig
menu "`---> stm8s103f evaluation board"


    
    
source "$COMMON_DIR_PATH/c/hw_drivers/arch/STM8/boards/stm8s103f/Kconfig.soc_stm8s103f.dt"


endmenu
```

## c/hw_drivers/arch/STM8/boards/stm8s103f/Kconfig.soc_stm8s103f.dt
```kconfig
menu "stm8s103f soc configuration"

config MAX_NUMBER_OF_CLOCKS
    hex
    default 2 
    
config INITIAL_CORE_CLOCK_RATE
    hex
    default 2000000 



#######################################
##########  clock tree  ###############

menu "clocks tree"

comment "CONFIG_DT_STM8_HSI_CLOCK : internal high speed clock"
config DT_STM8_HSI_CLOCK
    hex
    default 1 

config DT_STM8_HSI_CLOCK_RATE
    hex
    default 16000000 



comment "CONFIG_DT_CORE_CLOCK : cortex m systick clock"
config DT_CORE_CLOCK
    hex
    default 2

endmenu


##########  end of  clock tree  ###############
###############################################

##################################################
##########  interrupts definitions ###############

menu "interrupts"

comment "CONFIG_DT_STM8_UART1_TX_INTERRUPT : uart tx interrupt"
config DT_STM8_UART1_TX_INTERRUPT
    int
    default 17 

comment "CONFIG_DT_STM8_UART1_RX_INTERRUPT : uart rx interrupt"
config DT_STM8_UART1_RX_INTERRUPT
    int
    default 18 

endmenu


##########  end of interrupts definitions ###############
#########################################################
    


##################################################
##############  memories on soc ##################

menu "memories"

comment "sram start : 0x0"
config DT_SOC_RAM_START_ADDR
    hex 
    default 0x0

comment "sram size : 1k"
config DT_SOC_RAM_SIZE
    hex
    default 0x400    

comment "eeprom start : 0x4000"
config DT_SOC_EEPROM_START_ADDR
    hex
    default 0x4000

comment "eeprom size : 640"
config DT_SOC_EEPROM_SIZE
    int
    default 640
    
comment "flash start : 0x8000"
config DT_SOC_FLASH_START_ADDR
    hex
    default 0x8000

comment "flash size : 8k"
config DT_SOC_FLASH_SIZE
    hex
    default 0x2000   

endmenu

#############  end of memories on soc ###################
#########################################################






endmenu
```

## c/hw_drivers/arch/STM8/soc/Kconfig
```kconfig
choice
	prompt "SOC"
	default GENERIC_STM8_SOC

config STM8S103F
	bool "STM8S103F"
	select PUBLIC_SOC_SELECTED

config GENERIC_STM8_SOC
	bool "generic SOC"
	select PUBLIC_SOC_SELECTED

endchoice

if STM8S103F
source "$KCONFIG_PUBLIC_START_DIR/hw_drivers/arch/STM8/soc/stm8s103f/Kconfig"
endif

if GENERIC_STM8_SOC
source "$KCONFIG_PUBLIC_START_DIR/hw_drivers/arch/STM8/soc/generic_board_Kconfig"
endif
```

## c/hw_drivers/arch/STM8/soc/stm8s103f/Kconfig
```kconfig
menu "`--->  stm8s103f board configurations"

choice
	prompt "Board"
	default STM8S103F_EB

config STM8S103F_EB
	bool "stm8s103f evaluation board"

endchoice

if STM8S103F_EB
source "$KCONFIG_PUBLIC_START_DIR/hw_drivers/arch/STM8/soc/stm8s103f/Kconfig.eb_stm8s103f.dt"
endif



endmenu

=======
config STM8S103F_BOARD
	def_bool y
	select INTERNAL_SRAM 
	select INTERNAL_FLASH 
	
```

## c/hw_drivers/arch/STM8/soc/stm8s103f/Kconfig.eb_stm8s103f.dt
```kconfig
menu "`---> stm8s103f evaluation board"


    
    
source "$KCONFIG_PUBLIC_START_DIR/hw_drivers/arch/STM8/soc/stm8s103f/Kconfig.soc_stm8s103f.dt"


endmenu
```

## c/hw_drivers/arch/TENSILICA/soc/Kconfig
```kconfig
choice
	prompt "SOC"
	default ESP8266

config ESP8266
	bool "ESP8266"

endchoice


if ESP8266
source "$KCONFIG_START_DIR_PATH/hw_drivers/arch/TENSILICA/soc/esp8266/Kconfig"
endif
```

## c/hw_drivers/arch/TENSILICA/soc/esp8266/Kconfig.esp_01.dt
```kconfig
menu "`---> esp_01 evaluation board"

    
    
source "$KCONFIG_START_DIR_PATH/hw_drivers/arch/TENSILICA/soc/esp8266/Kconfig.esp8266.dt"


endmenu
```

## c/hw_drivers/arch/XTENSA/soc/Kconfig
```kconfig
choice
	prompt "SOC"
	default XTENSA_SIM

config ESP8266
	bool "ESP8266"
	select XTENSA_LX6
	select PUBLIC_SOC_SELECTED

config XTENSA_SIM
	bool "simulator"
	select PUBLIC_SOC_SELECTED

config XTENSA_FPGA_SIM
	bool "fpga simulator"
	select PUBLIC_SOC_SELECTED

config I96XXX_HIFI3
	bool "i96xxx hifi3"
	select PUBLIC_SOC_SELECTED
	select XTENSA_HIFI3_NTCA

config NPCP415
	bool "npcp415"
	select PUBLIC_SOC_SELECTED
	select XTENSA_FUSIONF1_P7_G60_NTCA

endchoice

if XTENSA_SIM || XTENSA_FPGA_SIM

choice
	prompt "Xtensa core configuration"
	default XTENSA_LX6_

config XTENSA_LX6_
	bool "lx6"
	select XTENSA_LX6

config XTENSA_LX7_
	bool "lx7"
	select XTENSA_LX7

config XTENSA_FUSIONF1_XRC_ALL_CACHE
	bool "XRC_FusionF1_All_cache"

endchoice

endif

config XTENSA_APP_DEPENDENT_CONFIG
	bool "use application dependant xtensa config"
	default n

if XTENSA_APP_DEPENDENT_CONFIG

config XTENSA_CORE_CONFIG
    string "core configuration name"
    default ""

config XTENSA_MEMMAP_CONFIG
    string "memmap configuration name. leave empty if none"
    default ""

endif

if ESP8266
source "$KCONFIG_PUBLIC_START_DIR/hw_drivers/arch/XTENSA/soc/esp8266/Kconfig"
endif

if XTENSA_SIM
source "$KCONFIG_PUBLIC_START_DIR/hw_drivers/arch/XTENSA/soc/sim/Kconfig"
endif

if XTENSA_FPGA_SIM
source "$KCONFIG_PUBLIC_START_DIR/hw_drivers/arch/XTENSA/soc/fpga_sim/Kconfig"
endif

if I96XXX_HIFI3
source "$KCONFIG_PUBLIC_START_DIR/hw_drivers/arch/XTENSA/soc/i96xxx_HiFi3/Kconfig"
endif

if NPCP415
source "$KCONFIG_PUBLIC_START_DIR/hw_drivers/arch/XTENSA/soc/npcp415/Kconfig"
endif


config XTENSA_MAIN_STACK_SIZE_BYTES
	int   "initial and interrupt stack size (in bytes)"
	depends on XTENSA
	default 1024


config XTENSA_LX6
	bool
	
config XTENSA_LX7
	bool
	
config XTENSA_HIFI3_BD5
	bool
```

## c/hw_drivers/arch/XTENSA/soc/esp8266/Kconfig
```kconfig
menu "`--->  esp8266 board configurations"

choice
	prompt "Board"
	default ESP_01

config ESP_01
	bool "ESP-01"

endchoice

if ESP_01
source "$KCONFIG_START_DIR_PATH/hw_drivers/arch/XTENSA/soc/esp8266/Kconfig.esp_01.dt"
endif


choice
	prompt "SDK type"
	default SDK_NONOS

config SDK_NONOS
	bool "SDK without OS"

config SDK_RTOS
	bool "SDK with RTOS"

endchoice

endmenu
```

## c/hw_drivers/arch/XTENSA/soc/esp8266/Kconfig.esp_01.dt
```kconfig
menu "`---> esp_01 evaluation board"

    
    
source "$KCONFIG_PUBLIC_START_DIR/hw_drivers/arch/XTENSA/soc/esp8266/Kconfig.esp8266.dt"


endmenu
```

## c/hw_drivers/arch/XTENSA/soc/i96xxx_HiFi3/Kconfig
```kconfig
menu "`---> I96XXX HIFI3 configurations"

config XTENSA_HIFI3_NTCA
	bool
	depends on XCC_TOOLS_VER_RI_2018_0

config BSP_I96XXX_GIT_COMMIT_HASH
	string "BSP i96xxx git commit hash"
	default ""

endmenu
```

## c/hw_drivers/arch/XTENSA/soc/npcp415/Kconfig
```kconfig
menu "`---> NPCP415 configurations"


if !XTENSA_APP_DEPENDENT_CONFIG

config XTENSA_FUSIONF1_P7_G60_NTCA
	bool "FusionF1_P7_NAU83G60"
	depends on XCC_TOOLS_VER_RI_2021_6

endif

endmenu
```

## c/hw_drivers/audio_codecs/Kconfig
```kconfig
#
	
menu "audio_codecs"

config INCLUDE_INTERNAL_DMIC
	bool   "internal dmic"
	depends on I94XXX
	default n

config INCLUDE_NAU88L24
	bool   "NAU88L24"
	default n

config INCLUDE_NAU83GXX
	bool   "NAU83GXX"
	default n

if INCLUDE_NAU83GXX
source "$KCONFIG_PUBLIC_START_DIR/hw_drivers/audio_codecs/NAU83GXX/Kconfig"
endif


endmenu
```

## c/hw_drivers/audio_codecs/NAU83GXX/Kconfig
```kconfig
#
	
menu "`--->  NAU83GXX configurations"

config NAU83GXX_ENABLE_DB_LAB_SHELL_COMMANDS
	bool "enable NAU83GXX db-lab shell commands"
	default n

config NAU83GXX_USE_KCS_REMOTE_INTERFACE
	bool "use KCS remote interface"
	default n

config NAU83GXX_USE_KCS_REMOTE_INTERFACE_GIT_COMMIT_HASH
	string "KCS remote interface git commit hash"
    depends on NAU83GXX_USE_KCS_REMOTE_INTERFACE
	default ""


endmenu
```

## c/hw_drivers/dma/Kconfig
```kconfig
#

if I94XXX
source "$KCONFIG_PUBLIC_START_DIR/hw_drivers/dma/dma_i94xxx/Kconfig"
endif
```

## c/hw_drivers/dma/dma_i94xxx/Kconfig
```kconfig
#
	
config  DMA_I94XXX_NUM_OF_BUFFERS
	int   "number of buffers per dma channel"
	default 5

config  DMA_I94XXX_NUM_OF_PREFFILED_BUFFERS_BEFORE_STARTING
	int   "number of buffers to prefill before starting of dma"
	default 2
```

## c/hw_drivers/storage/Kconfig
```kconfig
#
	
menu "storage"

config INCLUDE_INTERNAL_FLASH
	bool   "internal flash"
	depends on I94XXX
	default n

menuconfig INCLUDE_SPI_FLASH
	bool   "spi flash"
	depends on INCLUDE_INTERNAL_SPI
	default n

if INCLUDE_SPI_FLASH
source "$KCONFIG_START_DIR_PATH/hw_drivers/storage/spi_flash/Kconfig"
endif


endmenu
```

## c/sw_packages/Kconfig
```kconfig
#

menuconfig INCLUDE_CMSIS
	bool   "cortex-M CMSIS layer"
	depends on CORTEX_M0 || CORTEX_M3 || CORTEX_M4
	default y

config CMSIS_VERSION
	string   "CMSIS version in form of x.xx"
	depends on INCLUDE_CMSIS
	default "3.01"


source "$KCONFIG_PUBLIC_START_DIR/sw_packages/core/Kconfig"

source "$KCONFIG_PUBLIC_START_DIR/sw_packages/application_framework/Kconfig"

source "$KCONFIG_PUBLIC_START_DIR/sw_packages/ancillary/Kconfig"

source "$KCONFIG_PUBLIC_START_DIR/sw_packages/management/Kconfig"

source "$KCONFIG_PUBLIC_START_DIR/sw_packages/utilities/Kconfig"

source "$KCONFIG_PUBLIC_START_DIR/sw_packages/storage/Kconfig"

source "$KCONFIG_PUBLIC_START_DIR/sw_packages/dsp/Kconfig"

source "$KCONFIG_PUBLIC_START_DIR/sw_packages/net/Kconfig"

source "$KCONFIG_PUBLIC_START_DIR/sw_packages/usb_device/Kconfig"

source "$KCONFIG_PUBLIC_START_DIR/sw_packages/staging/Kconfig"
```

## c/sw_packages/PRINTF/Kconfig
```kconfig
#
	
menu "PRINTF"

config DISABLE_DBG_PRINTS
	bool   "disable debug prints"
	depends on INCLUDE_PRINTF
	default n

config USE_MINIMAL_PRINTF
	bool   "use only minimal capabilities"
	default n	

endmenu
```

## c/sw_packages/ancillary/Kconfig
```kconfig
#

menu "ancillary"

menuconfig INTERNAL_FILE_DESCRIPTORS_MANAGER 
	bool   "internal file descriptor manager"
	default n
if INTERNAL_FILE_DESCRIPTORS_MANAGER
source "$KCONFIG_PUBLIC_START_DIR/sw_packages/ancillary/file_descriptors_manager/Kconfig"
endif


config INCLUDE_LINUX_TIMER
	bool   "linux timer"
	depends on HOST
	default n


menuconfig INCLUDE_ASYNC_TX_WRAPPER
	bool   "async tx wrapper"
	depends on (INCLUDE_INTERNAL_UART || INCLUDE_USB_VIRTUAL_COM || \
				INCLUDE_WIRELESS_UART || INCLUDE_SEMIHOSTING || \
				INCLUDE_LINUX_UART)
	default n

if INCLUDE_ASYNC_TX_WRAPPER
source "$KCONFIG_PUBLIC_START_DIR/sw_packages/ancillary/async_tx_wrapper/Kconfig"
endif

menuconfig INCLUDE_ASYNC_RX_WRAPPER
	bool   "async rx wrapper"
	depends on (INCLUDE_INTERNAL_UART || INCLUDE_USB_VIRTUAL_COM || \
				INCLUDE_WIRELESS_UART || INCLUDE_SEMIHOSTING || \
				INCLUDE_LINUX_UART)
	default n

if INCLUDE_ASYNC_RX_WRAPPER
source "$KCONFIG_PUBLIC_START_DIR/sw_packages/ancillary/async_rx_wrapper/Kconfig"
endif

config INCLUDE_TIMER_WRAPPER
	bool   "timer wrapper"
	depends on INCLUDE_HW_TIMER || INCLUDE_LINUX_TIMER
	default n


config INCLUDE_SW_GPIO_WRAPPER
	bool   "sw gpio wrapper"
	depends on INCLUDE_INTERNAL_GPIO
	default n

	
config INCLUDE_BUTTON_MANAGER
	bool   "button manager"
	depends on INCLUDE_SW_GPIO_WRAPPER || INCLUDE_INTERNAL_GPIO
	default n

menuconfig INCLUDE_MEMORY_POOL
	bool   "memory pool"
	default n

config MEMORY_POOL_IS_SPEED_CRITICAL 
	bool   "memory pool is speed critical"
	depends on INCLUDE_MEMORY_POOL
	default n
	
	
endmenu
```

## c/sw_packages/ancillary/async_rx_wrapper/Kconfig
```kconfig
#
	
config  ASYNC_RX_WRAPPER_USE_MALLOC
	bool   "use malloc in async rx driver"
	default y

	
config  ASYNC_RX_WRAPPER_RX_BUFFER_SIZE
	int   "rx buffer size"
	depends on !ASYNC_RX_WRAPPER_USE_MALLOC
	default 32
```
