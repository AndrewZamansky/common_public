## c/hw_drivers/arch/ARM/soc/i94xxx/Kconfig
```kconfig
menu "`--->  I94XXX configurations"


config BSP_I94XXX_GIT_COMMIT_HASH
	string "BSP i94xxx git commit hash"
	default ""


choice
	prompt "I94XXX flavors"
	default I94130

config I94124
	bool "I94124"
	select I9412X_512K_FLASH
	select I941X4_196K_SRAM

config I94113
	bool "I94113"
	select I9411X_256K_FLASH
	select I941X3_128K_SRAM

config I94131
	bool "I94131"
	select I9413X_128K_FLASH
	select I941X1_64K_SRAM

config I94130
	bool "I94130"
	select I9413X_128K_FLASH
	select I941X0_48K_SRAM

endchoice


=======
config I9413X_128K_FLASH
	def_bool n

config I9411X_256K_FLASH
	def_bool n

config I9412X_512K_FLASH
	def_bool n


config I941X0_48K_SRAM
	def_bool n

config I941X1_64K_SRAM
	def_bool n

config I941X3_128K_SRAM
	def_bool n

config I941X4_196K_SRAM
	def_bool n

endmenu

	
```

## c/hw_drivers/arch/ARM/soc/i94xxx/Kconfig.socI94XXX.dt
```kconfig
menu "I94XXX soc configuration"


config I94XXX_BSP_VERSION
    string "nuc bsp version in form : xx.xx[.xx]"
    default "00.01"


comment "number of external interrupts : 68"
config DT_NUMBER_OF_EXTERNAL_INTERRUPTS
    int
    default 68

endmenu
```

## c/hw_drivers/arch/ARM/soc/i94xxx/Kconfig.svbI94120.dt
```kconfig
menu "`---> I94XXX SVB board"


config CRYSTAL_CLOCK
    int "crystal clock in Hz"
    default 12000000 
    
    
source "$KCONFIG_PUBLIC_START_DIR/hw_drivers/arch/ARM/soc/i94xxx/Kconfig.socI94XXX.dt"


endmenu
```

## c/hw_drivers/arch/ARM/soc/i94xxx/Kconfig.svbMCP.dt
```kconfig
menu "`---> MCP SVB board"

source "$KCONFIG_PUBLIC_START_DIR/hw_drivers/arch/ARM/soc/i94xxx/Kconfig.socI94XXX.dt"

endmenu
```

## c/hw_drivers/arch/ARM/soc/i96xxx_M0/Kconfig
```kconfig
menu "`--->  I96XXX M0 configurations"


config  I96XXX_SPIM_FLASH_SIZE
	hex   "spim flash size"
	default 0x100000

config BSP_I96XXX_GIT_COMMIT_HASH
	string "BSP i96xxx git commit hash"
	default ""

endmenu

	
```

## c/hw_drivers/arch/ARM/soc/npce586/Kconfig
```kconfig
menu "`--->  npce586 board configurations"

choice
	prompt "Board"
	default NPCE586_EB

config NPCE586_EB
	bool "npce586 evaluation board"

endchoice

if NPCE586_EB
source "$KCONFIG_START_DIR_PATH/hw_drivers/arch/ARM/soc/npce586/Kconfig.eb.npce586.dt"
endif



endmenu

=======
config NPCE586_EB_BOARD
	def_bool y
	select INTERNAL_SRAM 
	select CORTEX_M4 
	select SOC_HAS_DSP
```

## c/hw_drivers/arch/ARM/soc/npce586/Kconfig.eb.npce586.dt
```kconfig
menu "`---> npce586 evaluation board"


config CRYSTAL_CLOCK
    int "crystal clock in Hz"
    default 32000000 
    
    
source "$KCONFIG_START_DIR_PATH/hw_drivers/arch/ARM/soc/npce586/Kconfig.soc.npce586.dt"


endmenu
```

## c/hw_drivers/arch/ARM/soc/npce586/Kconfig.soc.npce586.dt
```kconfig
menu "npce586 soc configuration"

config MAX_NUMBER_OF_CLOCKS
    hex
    default 2 
    
config INITIAL_CORE_CLOCK
    hex
    default CRYSTAL_CLOCK 


#######################################
##########  clock tree  ###############

menu "clocks tree"

comment "CONFIG_DT_XTAL_CLOCK : external crystal clock"
config DT_XTAL_CLOCK
    hex
    default 1 

config DT_XTAL_CLOCK_RATE
    hex
    default CRYSTAL_CLOCK 



comment "CONFIG_DT_CORE_CLOCK : cortex m systick clock"
config DT_CORE_CLOCK
    hex
    default 2

endmenu


##########  end of  clock tree  ###############
###############################################



##################################################
##############  memories on soc ##################

menu "memories"

comment "sram start : 0x10088000"
config DT_SOC_RAM_START_ADDR
    hex 
    default 0x10088000

comment "sram size : 0x40000"
config DT_SOC_RAM_SIZE
    hex
    default 0x40000    

endmenu

#############  end of memories on soc ###################
#########################################################



menu "systick"
	
comment "CONFIG_DT_CORTEX_M_SYSTICK_INPUT_CLOCK : systick clock"

config DT_CORTEX_M_SYSTICK_INPUT_CLOCK
	int   
	default DT_CORE_CLOCK

comment "CONFIG_DT_CORTEX_M_SYSTICK_INTERRUPT : systick interrupt"


endmenu

endmenu
```

## c/hw_drivers/arch/ARM/soc/nuc505/Kconfig
```kconfig
menu "`--->  nuc505 board configurations"

choice
	prompt "Board"
	default NUC505_EB

config NUC505_EB
	bool "nuc505 evaluation board"

endchoice

if NUC505_EB
source "$KCONFIG_PUBLIC_START_DIR/hw_drivers/arch/ARM/soc/nuc505/Kconfig.eb505.dt"
endif



endmenu

=======
config NUC505_BOARD
	def_bool y
	select INTERNAL_SRAM 
	select INTERNAL_FLASH 
	select CORTEX_M4 
	select SOC_HAS_DSP
```

## c/hw_drivers/arch/ARM/soc/nuc505/Kconfig.eb505.dt
```kconfig
menu "`---> nuc505 evaluation board"


config CRYSTAL_CLOCK
    int "crystal clock in Hz"
    default 12000000 
    
    
source "$KCONFIG_PUBLIC_START_DIR/hw_drivers/arch/ARM/soc/nuc505/Kconfig.soc505.dt"


endmenu
```

## c/hw_drivers/arch/ARM/soc/nuc505/Kconfig.soc505.dt
```kconfig
menu "nuc505 soc configuration"


config NUC505_BSP_VERSION
    string "nuc bsp version in form : xx.xx[.xx]"
    default "3.00.003"

##################################################
##############  memories on soc ##################

menu "memories"

comment "sram start : 0x20000000"
config DT_SOC_RAM_START_ADDR
    hex 
    default 0x20000000

comment "sram size : 0x20000"
config DT_SOC_RAM_SIZE
    hex
    default 0x20000    

comment "flash start : 0x0"
config DT_SOC_FLASH_START_ADDR
    hex
    default 0x0

comment "flash size : 0x40000"
config DT_SOC_FLASH_SIZE
    hex
    default 0x40000   

endmenu

#############  end of memories on soc ###################
#########################################################


endmenu
```

## c/hw_drivers/arch/ARM/soc/poleg/Kconfig
```kconfig
config POLEG_BOARD
	def_bool y
	select INTERNAL_SRAM 
	select INTERNAL_ROM 
	select DDR 
	select EXTERNAL_FLASH
	select CORTEX_A9
```

## c/hw_drivers/arch/ARM/soc/stm32/stm32f103rc/Kconfig
```kconfig
menu "`--->  stm32f103rc board configurations"

choice
	prompt "Board"
	default EUSE_TAOBAO_BOARD

config EUSE_TAOBAO_BOARD
	bool "euse taobao board"

endchoice

if EUSE_TAOBAO_BOARD
source "$KCONFIG_START_DIR_PATH/hw_drivers/arch/ARM/soc/stm32/stm32f103rc/Kconfig.euse.taobao.dt"
endif



endmenu

=======
config STM32F103RC_BOARD
	def_bool y
	select INTERNAL_SRAM
	select INTERNAL_FLASH
	select CORTEX_M3
```

## c/hw_drivers/arch/ARM/soc/stm32/stm32f103rc/Kconfig.euse.taobao.dt
```kconfig
menu "`---> stm32f103rc euse taobao board"


config CRYSTAL_CLOCK
    int "crystal clock in Hz"
    default 8000000 
    
    
source "$KCONFIG_PUBLIC_START_DIR/hw_drivers/arch/ARM/soc/stm32/stm32f103rc/Kconfig.soc.stm32f103rc.dt"


endmenu
```

## c/hw_drivers/arch/ARM/soc/stm32/stm32f103xxx/Kconfig
```kconfig
menu "`--->  stm32f103xxx configurations"


config STM32F10X_BSP_VERSION
	string "st32f10x bsp version in form : xx.xx[.xx]"
	default "3.5.0"

choice
	prompt "stm32f103xxx flavors"
	default stm32f103xC

config stm32f103xC
	bool "stm32f103xC"
	select STM32F103xC_256K_FLASH
	select STM32F103xC_64K_SRAM

config stm32f103xD
	bool "stm32f103xD"
	select STM32F103xD_384K_FLASH
	select STM32F103xC_64K_SRAM

config stm32f103xE
	bool "stm32f103xE"
	select STM32F103xE_512K_FLASH
	select STM32F103xC_64K_SRAM

config stm32f103xF
	bool "stm32f103xF"
	select STM32F103xF_768K_FLASH
	select STM32F103xF_96K_SRAM


endchoice


=======
config STM32F103XXX_ADDITIONAL_OPTIONS
	def_bool n
	select CORTEX_M3
	
config STM32F103xC_256K_FLASH
	def_bool n

config STM32F103xD_384K_FLASH
	def_bool n

config STM32F103xE_512K_FLASH
	def_bool n

config STM32F103xF_768K_FLASH
	def_bool n



config STM32F103xC_64K_SRAM
	def_bool n

config STM32F103xF_96K_SRAM
	def_bool n


endmenu
```

## c/hw_drivers/arch/HEXAGON/soc/Kconfig
```kconfig
choice
	prompt "SOC"
	default APQ8096

config APQ8096
	bool "Snapdragon 820 apq8096"
	select PUBLIC_SOC_SELECTED

endchoice


if APQ8096
source "$KCONFIG_PUBLIC_START_DIR/hw_drivers/arch/HEXAGON/soc/apq8096/Kconfig"
endif


config HEXAGON_VERSION_60
    bool
    default n
```

## c/hw_drivers/arch/HEXAGON/soc/apq8096/Kconfig
```kconfig
menu "`--->  apq8096 board configurations"

choice
	prompt "Board"
	default OPENQ_820_SOM

config OPENQ_820_SOM
	bool "open-Q 820 SOM"

endchoice

if OPENQ_820_SOM
source "$KCONFIG_PUBLIC_START_DIR/hw_drivers/arch/HEXAGON/soc/apq8096/Kconfig.openq820som.dt"
endif



endmenu
```

## c/hw_drivers/arch/HEXAGON/soc/apq8096/Kconfig.apq8096.dt
```kconfig
menu "apq8096 soc configuration"

comment "selecting hexagon v60"
config SOC_APQ8096
	def_bool y
	select HEXAGON_VERSION_60 

endmenu
```

## c/hw_drivers/arch/HEXAGON/soc/apq8096/Kconfig.openq820som.dt
```kconfig
menu "`---> openq820som evaluation board"

    
    
source "$KCONFIG_PUBLIC_START_DIR/hw_drivers/arch/HEXAGON/soc/apq8096/Kconfig.apq8096.dt"


endmenu
```

## c/hw_drivers/arch/Kconfig
```kconfig
#

    	
menu "Platform configurations"

if ARM
source "$KCONFIG_PUBLIC_START_DIR/hw_drivers/arch/ARM/soc/Kconfig"
endif


if STM8
source "$KCONFIG_PUBLIC_START_DIR/hw_drivers/arch/STM8/soc/Kconfig"
endif

if PIC32
source "$KCONFIG_PUBLIC_START_DIR/hw_drivers/arch/PIC32/soc/Kconfig"
endif


if HEXAGON
source "$KCONFIG_PUBLIC_START_DIR/hw_drivers/arch/HEXAGON/soc/Kconfig"
endif

if XTENSA
source "$KCONFIG_PUBLIC_START_DIR/hw_drivers/arch/XTENSA/soc/Kconfig"
endif

config PUBLIC_SOC_SELECTED
    bool
    default n


if !HEXAGON && !ANDROID_NDK && !OUTPUT_TYPE_STATIC_LIBRARY

config PROJECT_IS_BOOTLOADER
    bool "this project is bootloader"
    default n

config BUILD_FOR_USE_WITH_BOOTLOADER
	bool   "build for use with bootloader"
    depends on !PROJECT_IS_BOOTLOADER
	default n


config USE_APPLICATION_SPECIFIC_SCATTER_FILE
	bool "use application specifc scatter file"
    depends on ARM || XTENSA
    default n

if !USE_APPLICATION_SPECIFIC_SCATTER_FILE

choice
	prompt "code location"
	default CODE_LOCATION_INTERNAL_FLASH

config CODE_LOCATION_INTERNAL_FLASH
	bool "internal flash"
	depends on INTERNAL_FLASH_EXISTS

config CODE_LOCATION_EXTERNAL_FLASH
	bool "external flash"
	depends on EXTERNAL_FLASH_EXISTS

config CODE_LOCATION_INTERNAL_SRAM
	bool "internal sram"
	depends on INTERNAL_SRAM_EXISTS

config CODE_LOCATION_DDR
	bool "ddr"
	depends on DDR_EXISTS
endchoice


choice
	prompt "data/bss location"
	default DATA_LOCATION_INTERNAL_SRAM

config DATA_LOCATION_INTERNAL_SRAM
	bool "internal sram"
	depends on INTERNAL_SRAM_EXISTS

config DATA_LOCATION_DDR
	bool "ddr"
	depends on DDR_EXISTS
endchoice


choice
	prompt "speed critical code location"
	default SPEED_CRITICAL_CODE_LOCATION_INTERNAL_SRAM

config SPEED_CRITICAL_CODE_LOCATION_INTERNAL_FLASH
	bool "internal flash"
	depends on INTERNAL_FLASH_EXISTS

config SPEED_CRITICAL_CODE_LOCATION_EXTERNAL_FLASH
	bool "external flash"
	depends on EXTERNAL_FLASH_EXISTS

config SPEED_CRITICAL_CODE_LOCATION_INTERNAL_SRAM
	bool "internal sram"
	depends on INTERNAL_SRAM_EXISTS

config SPEED_CRITICAL_CODE_LOCATION_DDR
	bool "ddr"
	depends on DDR_EXISTS
endchoice

endif #### (if !USE_APPLICATION_SPECIFIC_SCATTER_FILE)


config EXCEPTION_STACKS_DEBUG
	bool "fill system stacks with pattern (help to debug stack overflow)"
    depends on CORTEX_A9 || CORTEX_M3 || CORTEX_M4
    default n


endif #### (if !HEXAGON && !ANDROID_NDK && !OUTPUT_TYPE_STATIC_LIBRARY)


# following configuration will be selected automatically
config INTERNAL_FLASH_EXISTS
    bool
    default n

config EXTERNAL_FLASH_EXISTS
    bool
    default n

config INTERNAL_SRAM_EXISTS
    bool
    default n

config DDR_EXISTS
    bool
    default n
################################

endmenu
```

## c/hw_drivers/arch/PIC32/soc/Kconfig
```kconfig
choice
	prompt "SOC"
	default GENERIC_PIC32_SOC

config PIC32MX575
	bool "PIC32MX575"
	select PUBLIC_SOC_SELECTED

config PIC32_GENERIC_PIC32_SOC
	bool "generic SOC"
	select PUBLIC_SOC_SELECTED

endchoice

if PIC32MX575
source "$KCONFIG_PUBLIC_START_DIR/hw_drivers/arch/PIC32/soc/pic32mx575/Kconfig"
endif

if PIC32_GENERIC_PIC32_SOC
source "$KCONFIG_PUBLIC_START_DIR/hw_drivers/arch/PIC32/soc/generic_board_Kconfig"
endif
```

## c/hw_drivers/arch/PIC32/soc/pic32mx575/Kconfig
```kconfig
menu "`--->  pic32mx575 board configurations"

choice
	prompt "Board"
	default BARAK_SVB_REV_B

config BARAK_SVB_REV_B
	bool "barak svb rev.B"

endchoice

if BARAK_SVB_REV_B
source "$KCONFIG_PUBLIC_START_DIR/hw_drivers/arch/PIC32/soc/pic32mx575/Kconfig.barak_svb.dt"
endif



endmenu

=======
config PIC32MX575_BOARD
	def_bool y
	select INTERNAL_SRAM 
	select INTERNAL_FLASH 
	
```

## c/hw_drivers/arch/PIC32/soc/pic32mx575/Kconfig.barak_svb.dt
```kconfig
menu "`---> barak svb rev.B"


    
    
source "$KCONFIG_PUBLIC_START_DIR/hw_drivers/arch/PIC32/soc/pic32mx575/Kconfig.soc_pic32mx575.dt"


endmenu
```

## c/hw_drivers/arch/PIC32/soc/pic32mx575/Kconfig.soc_pic32mx575.dt
```kconfig
menu "pic32mx575 soc configuration"


##################################################
##############  memories on soc ##################

menu "memories"

comment "sram start : 0xA0000000"
config DT_SOC_RAM_START_ADDR
    hex 
    default 0xA0000000

comment "sram size : 64k"
config DT_SOC_RAM_SIZE
    hex
    default 0x10000    

comment "flash start : 0x9d000000"
config DT_SOC_FLASH_START_ADDR
    hex
    default 0x9d000000

comment "flash size : 0x81000"
config DT_SOC_FLASH_SIZE
    hex
    default 0x81000

endmenu

#############  end of memories on soc ###################
#########################################################



endmenu
```

## c/hw_drivers/arch/STM8/Kconfig
```kconfig
choice
	prompt "Compiler"
	default CXSTM8

config CXSTM8
	bool "cosmic compiler for stm8 "

endchoice
```
