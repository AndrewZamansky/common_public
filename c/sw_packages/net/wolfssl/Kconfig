## c/sw_packages/net/wolfssl/Kconfig
```kconfig
#

config  WOLFSSL_SHA256
	bool   "sha256"
	default n

config  WOLFSSL_MD5
	bool   "md5"
	default n

config  WOLFSSL_TLS
	bool   "tls"
	default n

config  WOLFSSL_ECC
	bool   "ecc"
	default n

config  WOLFSSL_AES
	bool   "aes"
	default n

config  WOLFSSL_RSA
	bool   "rsa"
	default n

config  WOLFSSL_DH
	bool   "dh"
	default n

config  WOLFSSL_HMAC
	bool   "hmac"
	default n


menu "wolf cipher suites"

config  WOLFSSL_DHE_RSA_WITH_AES_128_GCM_SHA256
	bool   "DHE_RSA_WITH_AES_128_GCM_SHA256"
	select WOLFSSL_AES
	select WOLFSSL_SHA256
	default n

endmenu

config  WOLFSSL_DONT_USE_FILESYSTEM
	bool   "don't use filesystem"
	default n


config  WOLFSSL_USE_CUSTOM_RANDOM_GENERATOR
	bool   "use custom random generator"
	default n

config WOLFSSL_GIT_COMMIT_HASH
	string "wolfSSL git commit hash"
	default ""
```

## c/sw_packages/os_wrapper/Kconfig
```kconfig
choice
	prompt "RT OS select"
	default NONE_RT_OS

config FREE_RTOS
	bool "freeRtos"

config ATOM_THREADS
	bool "atomthreads"

config NONE_RT_OS
	bool "none"

endchoice

if FREE_RTOS || ATOM_THREADS
config RT_OS_IS_SPEED_CRITICAL
	bool   "RT OS is speed critical"
	default n
endif
```

## c/sw_packages/shell/Kconfig
```kconfig
#
	
menu "shell options"

config  SHELL_MAX_NUM_OF_DYNAMIC_INSTANCES
	int   "maximal number of dynamic instances"
	default 1
	
config  SHELL_MAX_QUEUE_LEN
	int   "internal queue length"
	default 3
	
endmenu
```

## c/sw_packages/staging/Kconfig
```kconfig
#

menu "staging"

config INCLUDE_UGFX
	bool   "ugfx"
	depends on !GCC_TARGET_OS_LINUX && !HOST
	default n

endmenu
```

## c/sw_packages/staging/juce/Kconfig
```kconfig
#

menu "juce configuration"

choice
	prompt "juce project type"
	default JUCE_STANDALONE_APPLICATION

config JUCE_STANDALONE_APPLICATION
	bool "standalone application"

config JUCE_VST_PLUGIN
    bool "vst plugin"

endchoice
	
endmenu
```

## c/sw_packages/storage/ArduinoSdSpi/Kconfig
```kconfig
config ARDUINO_SD_SPI_GIT_COMMIT_HASH
	string "arduino SdSpi git commit hash"
	default ""
```

## c/sw_packages/storage/Kconfig
```kconfig
#

menu "storage"


config INCLUDE_SPI_FLASH_PARTITION_MANAGER
	bool   "spi flash partition manager"
	depends on INCLUDE_SPI_FLASH
	default n

menuconfig INCLUDE_FAT_FS
	bool   "fat fs"
	#depends on INCLUDE_SPI_FLASH_PARTITION_MANAGER
	default n
	
config FAT_FS_VERSION
    string "nuc bsp version in form : x.xx[x]"
	depends on INCLUDE_FAT_FS
    default "0.10b"

menuconfig INCLUDE_ARDUINO_SD_SPI
	bool   "arduino sd over spi"
	depends on INCLUDE_INTERNAL_SPI
	default n

if INCLUDE_ARDUINO_SD_SPI
source "$KCONFIG_PUBLIC_START_DIR/sw_packages/storage/ArduinoSdSpi/Kconfig"
endif
	
endmenu
```

## c/sw_packages/sw_uart_wrapper/Kconfig
```kconfig
#
	
menu "software uart wrapper options"

config  SW_UART_WRAPPER_MAX_NUM_OF_DYNAMIC_INSTANCES
	int   "maximal number of dynamic instances"
	default 1
	
config  SW_UART_WRAPPER_MAX_QUEUE_LEN
	int   "internal queue length"
	default 10

config  SW_UART_WRAPPER_USE_MALLOC
	bool   "use malloc"
	default 1
	
config  SW_UART_WRAPPER_ENABLE_RX
	bool   "rx enable"
	default 1
	
config  SW_UART_WRAPPER_MAX_RX_BUFFER_SIZE
	int   "rx buffer size"
	depends on SW_UART_WRAPPER_ENABLE_RX
	default 2048
	
config  SW_UART_WRAPPER_MAX_TX_BUFFER_SIZE
	int   "internal queue length"
	default 255
	
endmenu
```

## c/sw_packages/u_boot_shell/Kconfig
```kconfig
config  U_BOOT_SHELL_MAX_NUM_OF_DYNAMIC_INSTANCES 
	int   "maximal number of dynamic instances"
	default 1


config SYS_MAXARGS
	int   "maximal number of arguments"
	default 8

menu "common uboot shell commands"

config UBOOT_CMD_GET_VERSION
	bool   "get version"
	depends on INCLUDE_VERSION_MENAGMENT
	default y

config UBOOT_CMD_GET_SERIAL
	bool   "get serial"
	depends on INCLUDE_SERIAL_NUMBER
	default n
	
config UBOOT_CMD_HEAP_TEST
	bool   "heap test"
	default n
	
config UBOOT_CMD_BOARD_IP
	bool   "board ip"
	depends on INCLUDE_ESP8266
	default n
	
config UBOOT_CMD_BOARD_NAME
	bool   "board name"
	default n
	
config UBOOT_CMD_GET_DEV_PARAM
	bool   "get device parameter"
	depends on INCLUDE_DEV_MENAGMENT
	default n
	
config UBOOT_CMD_SET_DEV_PARAM
	bool   "save device parameter"
	depends on INCLUDE_DEV_MENAGMENT
	default n
	
config UBOOT_CMD_PRINTF_DEV
	bool   "manage printf devices"
	depends on INCLUDE_PRINTF
	default n	
	
config UBOOT_CMD_SPI_FORMAT
	bool   "spi flash format"
	depends on INCLUDE_SPI_FLASH_PARTITION_MANAGER
	default n		
							
endmenu
```

## c/sw_packages/usb_device/Kconfig
```kconfig
#

if INCLUDE_INTERNAL_USB_DEVICE

menu "usb devices"

config INCLUDE_USB_AUDIO_CLASS
	bool   "usb audio class"
	default n
	
config INCLUDE_USB_VIRTUAL_COM_CLASS
	bool   "usb virtual com class"
	default n

config INCLUDE_USB_HID_CLASS
	bool   "usb hid class"
	default n

endmenu

endif
```

## c/sw_packages/utilities/Kconfig
```kconfig
#

menu "utilities"

menuconfig INCLUDE_CJSON
	bool   "cJSON"
	default n
if INCLUDE_CJSON
source "$KCONFIG_PUBLIC_START_DIR/sw_packages/utilities/cJSON/Kconfig"
endif

config INCLUDE_JSMN
	bool   "jsmn"
	default n

config INCLUDE_CRC
	bool   "crc32"
	default n

	
endmenu
```

## qaic/Kconfig
```kconfig
#

config PROJECT_NAME
	string "Project Name"
	default ""

menuconfig PROJECT_IS_PART_OF_BUNDLE
	bool "this project is part of bundle"
	default n

config NAME_SUFFIX_IN_BUNDLE
	string "Project Name Suffix"
	depends on PROJECT_IS_PART_OF_BUNDLE
	default ""

menuconfig OUTPUT_NAME_CHOOSEN_AUTOMATICALLY
	bool "name of final output is choosen automatically"
	default y

config REDEFINED_OUTPUT_NAME
	string "name of final output"
	depends on !OUTPUT_NAME_CHOOSEN_AUTOMATICALLY
	default "out"

source "$KCONFIG_PUBLIC_START_DIR/soc/Kconfig"

menuconfig USE_COMMON_PRIVATE_PACKAGES
	bool   "use common private packages"
	default n

if 	USE_COMMON_PRIVATE_PACKAGES
source "$KCONFIG_PUBLIC_START_DIR/../../common_private/Kconfig"
config COMMON_PRIVATE_GIT_COMMIT_HASH
	string "common private git commit hash"
	default ""
endif


config COMMON_PUBLIC_GIT_COMMIT_HASH
	string "common public git commit hash"
	default ""
```

## qaic/soc/Kconfig
```kconfig
choice
	prompt "SOC"
	default APQ8096

config APQ8096
	bool "Snapdragon 820 apq8096"

endchoice
```
