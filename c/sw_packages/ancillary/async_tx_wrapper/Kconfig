## c/sw_packages/net/curl/Kconfig
```kconfig
#

menu "curl protocols support selection"

config  CURL_HTTP_PROTOCOL_SUPPORT
	bool   "http protocol"
	default n

config  CURL_FTP_PROTOCOL_SUPPORT
	bool   "ftp protocol"
	default n

config  CURL_TELNET_PROTOCOL_SUPPORT
	bool   "telnet protocol"
	default n

config  CURL_DICT_PROTOCOL_SUPPORT
	bool   "dict protocol"
	default n

config  CURL_TFTP_PROTOCOL_SUPPORT
	bool   "tftp protocol"
	default n

config  CURL_FILE_PROTOCOL_SUPPORT
	bool   "file protocol"
	default n

config  CURL_LDAP_PROTOCOL_SUPPORT
	bool   "ldap protocol"
	default n

config  CURL_IMAP_PROTOCOL_SUPPORT
	bool   "imap protocol"
	default n

config  CURL_SMTP_PROTOCOL_SUPPORT
	bool   "smtp protocol"
	default n

config  CURL_RTSP_PROTOCOL_SUPPORT
	bool   "rtsp protocol"
	default n

config  CURL_GOPHER_PROTOCOL_SUPPORT
	bool   "gopher protocol"
	default n

config  CURL_SMB_PROTOCOL_SUPPORT
	bool   "smb protocol"
	default n

config  CURL_POP3_PROTOCOL_SUPPORT
	bool   "pop3 protocol"
	default n

endmenu

config  CURL_ENABLE_CRYPTO_AUTHENTICATION
	bool   "enable cryptographic authentication"
	default n


config  CURL_USE_CUSTOM_CURL_CONFIG_H
	bool   "use custom curl_config.h file"
	default n

config  CURL_DEFAULT_RECIEVE_BUFFER_SIZE
	bool   "default buffer size"
	default y

config  CURL_RECIEVE_BUFFER_SIZE
	int   "receive buffer size"
	depends on !CURL_DEFAULT_RECIEVE_BUFFER_SIZE
	default 4096

config  CURL_DEFAULT_HTTP2_BUFFER_SIZE
	bool   "default http2 buffer size"
	default y

config  CURL_HTTP2_BUFFER_SIZE
	int   "http2 buffer size"
	depends on !CURL_DEFAULT_HTTP2_BUFFER_SIZE
	default 4096


config  CURL_ENABLE_PROXY
	bool   "enable proxy"
	default n

config  CURL_ENABLE_COOKIES
	bool   "enable cookies"
	default n

config  CURL_ENABLE_VERBOSE_STRINGS
	bool   "enable verbose strings"
	default n

config  CURL_ENABLE_DEBUG
	bool   "enable debug"
	depends on CURL_ENABLE_VERBOSE_STRINGS
	default n

choice
	prompt "ssl library"
	default CURL_NO_SSL

config  CURL_NO_SSL
	bool   "no ssl"

config  CURL_USE_OPENSSL
	bool   "use OpenSSL"
	select INCLUDE_OPENSSL
	select OPENSSL_MD5
	select OPENSSL_DES
	select OPENSSL_RSA
	select OPENSSL_DSA
	select OPENSSL_DH
	select OPENSSL_SOCKET

config  CURL_USE_WOLFSSL
	bool   "use wolfSSL"
	select WOLFSSL_SHA256
	select WOLFSSL_TLS
	select WOLFSSL_MD5
	select INCLUDE_WOLFSSL

endchoice

config  CURL_USE_NGHTTP2
	bool   "use nghttp2"
	select INCLUDE_NGHTTP2
	default n

config CURL_GIT_COMMIT_HASH
	string "curl git commit hash"
	default ""
```

## c/sw_packages/net/openssl/Kconfig
```kconfig
#

config  OPENSSL_MD5
	bool   "md5"
	default n

config  OPENSSL_DES
	bool   "des"
	default n

config  OPENSSL_RSA
	bool   "rsa"
	default n

config  OPENSSL_DSA
	bool   "dsa"
	default n

config  OPENSSL_DH
	bool   "dh"
	default n

config  OPENSSL_SOCKET
	bool   "enable sockets"
	default n


config OPENSSL_GIT_COMMIT_HASH
	string "OpenSSL git commit hash"
	default ""
```
