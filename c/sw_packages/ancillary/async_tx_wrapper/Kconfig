## c/sw_packages/ancillary/async_tx_wrapper/Kconfig
```kconfig
#
	
config  ASYNC_TX_WRAPPER_MAX_QUEUE_LEN
	int   "internal queue length"
	default 10

config  ASYNC_TX_WRAPPER_USE_MALLOC
	bool   "use malloc async tx driver"
	default y

config  ASYNC_TX_WRAPPER_MAX_TX_BUFFER_SIZE
	int   "maximal allowed tx buffer size"
	default 255
	depends on !ASYNC_TX_WRAPPER_USE_MALLOC
```

## c/sw_packages/ancillary/file_descriptors_manager/Kconfig
```kconfig
#
	
config MAX_NUMBER_OF_OPENED_FILE_DESCRIPTORS
	int "max number of opened file descriptors"
	default 8

config USE_INTERNAL_SOCKETS_IMPLEMENTATION
	bool "use internal sockets implementation"
	default n

config USE_INTERNAL_SOCKETS_TOGETHER_WITH_SYSTEM
	bool "use internal sockets together with system sockets"
	default n
	depends on USE_INTERNAL_SOCKETS_IMPLEMENTATION
```

## c/sw_packages/ancillary/sw_uart_wrapper/Kconfig
```kconfig
#
	
config  SW_UART_WRAPPER_MAX_QUEUE_LEN
	int   "internal queue length"
	default 10

config  SW_UART_WRAPPER_USE_MALLOC
	bool   "use malloc"
	default y

config  SW_UART_WRAPPER_MAX_TX_BUFFER_SIZE
	int   "tx buffer size"
	default 255
	depends on !SW_UART_WRAPPER_USE_MALLOC
	
config  SW_UART_WRAPPER_ENABLE_RX
	bool   "rx enable"
	default y
	
config  SW_UART_WRAPPER_RX_BUFFER_SIZE
	int   "rx buffer size"
	depends on SW_UART_WRAPPER_ENABLE_RX && !SW_UART_WRAPPER_USE_MALLOC
	default 32
	
config  SW_UART_WRAPPER_USE_RUNTIME_CONFIGURATION
	bool   "use runtime configuration for uart wrapper"
	default n
```

## c/sw_packages/ancillary/timer/Kconfig
```kconfig
#
	
config  TIMER_MAX_NUM_OF_DYNAMIC_INSTANCES
	int   "maximal number of dynamic instances"
	default 0
```

## c/sw_packages/application_framework/Kconfig
```kconfig
#

menu "application_framework"

menuconfig INCLUDE_JUCE
	bool   "juce"
	depends on HOST
	default n

if INCLUDE_JUCE
source "$KCONFIG_START_DIR_PATH/sw_packages/application_framework/juce/Kconfig"
endif


endmenu
```

## c/sw_packages/application_framework/juce/Kconfig
```kconfig
#

choice
	prompt "juce project type"
	depends on INCLUDE_JUCE
	default JUCE_STANDALONE_APPLICATION

config JUCE_STANDALONE_APPLICATION
	bool "standalone application"

config JUCE_VST_PLUGIN
    bool "vst plugin"

endchoice

config USE_SAVI_HOST_VST_PLUGIN_TESTER
    bool "use saviHost vst plugin tester"
	depends on JUCE_VST_PLUGIN
	default n


config JUCE_GIT_COMMIT_HASH
	string "juce git commit hash"
	depends on INCLUDE_JUCE
	default ""
```

## c/sw_packages/core/Kconfig
```kconfig
#

menu "core"

menuconfig INCLUDE_AUTO_INIT
	bool  "include auto init"
	default n

config INCLUDE_ONLY_AUTO_INIT_API
	bool   "include only auto init api"
	depends on INCLUDE_AUTO_INIT
	default n
	---help---
		If you dont want to compile the sources but only use API such as
		auto init macros.
		If now you are creating the library, implementation should exist in
		other library or in base application.
		If now you are creating application, implementation should exist in
		some library.

menuconfig INCLUDE_ERROR_HANDLING
	bool  "include error handling"
	default n

config INCLUDE_ONLY_ERROR_HANDLING_API
	bool   "include only error handling api"
	depends on INCLUDE_ERROR_HANDLING
	default n
	---help---
		If now you are creating the library, implementation should exist in
		other library or in base application.
		If now you are creating application, implementation should exist in
		some library.

menuconfig INCLUDE_DEV_MENAGMENT
	bool  "include devices manager"
	default n

if INCLUDE_DEV_MENAGMENT
source "$KCONFIG_PUBLIC_START_DIR/sw_packages/core/dev_management/Kconfig"
endif

config INCLUDE_VERSION_MENAGMENT
	bool   "version management"
	select INCLUDE_DEV_MENAGMENT
	default y

menuconfig INCLUDE_HEARTBEAT
	bool   "heartbeat routines"
	depends on !GCC_TARGET_OS_LINUX && !HOST
	default n

if INCLUDE_HEARTBEAT
config HEARTBEAT_IS_SPEED_CRITICAL
	bool   "hearbeat routines are speed critical"
	default n
endif


menu "OS"
depends on !ANDROID_NDK
source "$KCONFIG_PUBLIC_START_DIR/sw_packages/core/os_wrapper/Kconfig"


endmenu	


endmenu
```

## c/sw_packages/core/dev_management/Kconfig
```kconfig
#
	
config USE_SPECIFIC_MEMORY_LOCATION_FOR_DEVICES
	bool "devices placed in specific memory loactions"
	default n

menuconfig DYNAMIC_DEVICE_TREE
	bool   "dynamic device tree"
	depends on USE_SPECIFIC_MEMORY_LOCATION_FOR_DEVICES
	select USE_DEVICE_NAME_STRINGS
	default n

config DEVICE_TREE_LOCATION_ADDR
	hex   "device tree location address"
	depends on DYNAMIC_DEVICE_TREE
	default 0x40000

config DEVICE_TREE_MAXIMAL_SIZE
	hex   "device tree maximal size"
	depends on DYNAMIC_DEVICE_TREE
	default 0x400

menuconfig USE_DYNAMIC_DEVICES
	bool   "use dynamic devices"
	default n

config MAX_NUM_OF_DYNAMIC_DEVICES
	int   "maximal number of dynamic devices"
	depends on USE_DYNAMIC_DEVICES
	default 32

#following delimiter used for ending USE_DYNAMIC_DEVICES menu
config DEVICE_MANAGEMENT_DUMMY_DELIMITER
	bool
	default n

config USE_DEVICE_NAME_STRINGS
	bool   "use device name strings (increase code size)"
	depends on USE_SPECIFIC_MEMORY_LOCATION_FOR_DEVICES || USE_DYNAMIC_DEVICES
	default y

config USE_RUNTIME_DEVICE_CONFIGURATION_BY_PARAMETER_NAMES
	bool   "devices can be configured by parameter names"
	select USE_RUNTIME_DEVICE_CONFIGURATION
	default n 

config USE_RUNTIME_DEVICE_CONFIGURATION
	bool   "devices can be configured in runtime"
	default n 
```

## c/sw_packages/core/os_wrapper/FreeRTOS/Kconfig
```kconfig
menu "`---> freeRTOS configurations"

if !USE_ONLY_OS_API

config HEAP_SIZE
	int   "heap size"
	default 10240

config TEST_TASK_STACK
	bool   "add stack logs for tasks"
	default y

config FREERTOS_USE_COUNTING_SEMAPHORES
	bool   "use counting semaphores"
	default y

endif

config FREERTOS_GIT_COMMIT_HASH
	string "FreeRTOS git commit hash"
	default ""

endmenu
```

## c/sw_packages/core/os_wrapper/Kconfig
```kconfig
choice
	prompt "RT OS select"
	default NONE_RT_OS

config FREE_RTOS
	bool "freeRtos"

config ATOM_THREADS
	bool "atomthreads"

config OSA
	bool "osa (co-operative os)"

config LINUX_OS_WRAPPER
	bool "linux os wrapper"

config NONE_RT_OS
	bool "none"

endchoice

config USE_ONLY_OS_API
	bool   "use only OS API, dont include implementation"
	depends on !NONE_RT_OS && OUTPUT_TYPE_STATIC_LIBRARY
	default n


if FREE_RTOS
source "$KCONFIG_PUBLIC_START_DIR/sw_packages/core/os_wrapper/FreeRTOS/Kconfig"
endif

if !USE_ONLY_OS_API

if FREE_RTOS || ATOM_THREADS || OSA
config RT_OS_IS_SPEED_CRITICAL
	bool   "RT OS is speed critical"
	default n
endif

endif #for !USE_ONLY_OS_API
```

## c/sw_packages/dsp/Kconfig
```kconfig
#

menuconfig INCLUDE_DSP
	bool   "digital signal processing (DSP)"
	default n

if INCLUDE_DSP

###################  DSP menu ####################

choice
	prompt "real number format"
	default DSP_REAL_NUMBER_FORMAT_FLOATING_POINT

config DSP_REAL_NUMBER_FORMAT_FLOATING_POINT
	bool "floating point"

config DSP_REAL_NUMBER_FORMAT_FIXED_POINT
	bool "fixed point"

endchoice

###################  LIBFIXMATH  ####################


config LIBFIXMATH_GIT_COMMIT_HASH
	string "libfixmath git commit hash"
	depends on DSP_REAL_NUMBER_FORMAT_FIXED_POINT
	default ""

config FIXMATH_NO_CACHE
	bool   "disable cache in libfixmath"
	depends on DSP_REAL_NUMBER_FORMAT_FIXED_POINT
	default n

config FIXMATH_NO_OVERFLOW
	bool   "disable overflow detection libfixmath"
	depends on DSP_REAL_NUMBER_FORMAT_FIXED_POINT
	default n

config FIXMATH_NO_ROUNDING
	bool   "disable rounding accuricy in libfixmath"
	depends on DSP_REAL_NUMBER_FORMAT_FIXED_POINT
	default n

######################################################

###################  NATURE_DSP (xtensa)  ####################

config USE_NATURE_DSP
	bool   "use IntegIT NatureDSP"
	depends on DSP_REAL_NUMBER_FORMAT_FIXED_POINT && \
				(XTENSA_FUSIONF1_XRC_ALL_CACHE || XTENSA_FUSIONF1_P7_G60_NTCA)
	default n

#	depends on DSP_REAL_NUMBER_FORMAT_FIXED_POINT && (XTENSA_FUSIONF1_XRC_ALL_CACHE || XTENSA_FUSIONF1_P7_G60_NTCA)    

config NATURE_DSP_GIT_COMMIT_HASH
	string "NatureDSP git commit hash"
	depends on USE_NATURE_DSP
	default ""

######################################################

config INCLUDE_COMMON_DSP
	bool   "common dsp"
	default n

config DSP_IS_SPEED_CRITICAL
	bool   "dsp is speed critical"
	default y

config INCLUDE_BIQUAD_FILTER
	bool   "biquad_filter"
	default n

config INCLUDE_FIR_FILTER
	bool   "fir_filter"
	default n

config INCLUDE_UPSAMPLING_BY_INT
	bool   "upsampling by integer"
	default n

config INCLUDE_DOWNSAMPLING_BY_INT
	bool   "downsampling by integer"
	default n

menuconfig INCLUDE_MIXER
	bool   "mixer"
	default n

if INCLUDE_MIXER
source "$KCONFIG_PUBLIC_START_DIR/sw_packages/dsp/mixer/Kconfig"
endif

menuconfig INCLUDE_MULTIPLIER
	bool   "multiplier"
	default n

if INCLUDE_MULTIPLIER
source "$KCONFIG_PUBLIC_START_DIR/sw_packages/dsp/multiplier/Kconfig"
endif

config INCLUDE_PCM_SPLITTER
	bool   "pcm splitter"
	default n

config INCLUDE_PCM_MIXER
	bool   "pcm mixer"
	default n

config INCLUDE_DPWM_MIXER
	bool   "dpwm mixer"
	default n

config INCLUDE_VOICE_3D
	bool   "voice 3D effect"
	default n

config INCLUDE_DELAY
	bool   "delay"
	default n

config INCLUDE_RMS
	bool   "rms"
	default n

config INCLUDE_TONE_GENERATOR
	bool   "tone generator"
	default n

config INCLUDE_BAND_SPLITTER_BUTTERWORTH_6DB_GAIN
	bool   "band splitter butterworth 6db gain"
	default n


menu "staging"


config INCLUDE_FFMPEG
	bool   "ffmpeg"
	default n


config INCLUDE_FFT
	bool   "fft"
	default n



config INCLUDE_WEBRTC_AEC
	bool   "webrtc echo canceller"
	default n

config INCLUDE_WEBRTC_VAD
	bool   "webrtc voice activity detection"
	default n

endmenu


#################### end of DSP menu###############################

endif
```

## c/sw_packages/dsp/compressor/Kconfig
```kconfig
#
	
config INCLUDE_STANDARD_COMPRESSOR
	bool   "standard audio compressor"
	default n

config INCLUDE_STANDARD_COMPRESSOR_WITH_LOG
	bool   "standard audio compressor with log10"
	default n

menuconfig INCLUDE_LOOKAHEAD_COMPRESSOR
	bool   "look ahead audio compressor"
	default n

config COMPRESSOR_DEFAULT_CHUNK_SIZE
	int   "default chunk size"
	depends on INCLUDE_LOOKAHEAD_COMPRESSOR
	default 64

config COMPRESSOR_IS_SPEED_CRITICAL
	bool   "compressor is speed critical"
	depends on INCLUDE_COMPRESSOR
	default y
```

## c/sw_packages/dsp/mixer/Kconfig
```kconfig
#
	
config INCLUDE_2X1_MIXER
	bool   "mixer 2 inputs 1 outputs"
	default n

config INCLUDE_2X2_MIXER
	bool   "mixer 2 inputs 2 outputs"
	default n

config INCLUDE_3X1_MIXER
	bool   "mixer 3 inputs 1 outputs"
	default n

config INCLUDE_4X1_MIXER
	bool   "mixer 4 inputs 1 outputs"
	default n
```

## c/sw_packages/dsp/multiplier/Kconfig
```kconfig
#

config INCLUDE_MULTIPLIER_1CHANNEL
	bool   "1 channel multiplier"
	default n

config INCLUDE_MULTIPLIER_2CHANNEL
	bool   "2 channel multiplier"
	default n
```

## c/sw_packages/management/Kconfig
```kconfig
#

menu "management"

menuconfig INCLUDE_PRINTF
	bool   "printf"
	default n

if INCLUDE_PRINTF
source "$KCONFIG_PUBLIC_START_DIR/sw_packages/management/PRINTF/Kconfig"
endif


config INCLUDE_HTTP
	bool   "http"
	default n

config INCLUDE_LOADED_CONFIG
	bool   "loaded configuration"
	depends on INCLUDE_FAT_FS
	default n

menuconfig INCLUDE_SHELL
	bool   "shell"
	depends on INCLUDE_ASYNC_RX_WRAPPER
	select INCLUDE_PRINTF
	default n
	
if INCLUDE_SHELL
source "$KCONFIG_PUBLIC_START_DIR/sw_packages/management/shell_frontend/Kconfig"
endif


menuconfig INCLUDE_SHELL_PRESETS
	bool   "shell presets"
	default n


#if INCLUDE_SHELL || ARM_SEMIHOSTING_CONFIG_ENABLE_RX

menuconfig INCLUDE_UBOOT_SHELL
	bool   "uboot shell"
	default n

if INCLUDE_UBOOT_SHELL
source "$KCONFIG_PUBLIC_START_DIR/sw_packages/management/u_boot_shell/Kconfig"
endif

#endif
	
	
endmenu


######## automatically selected configurations #########
config INCLUDE_MANAGEMENT
	def_bool  y
	depends on INCLUDE_UBOOT_SHELL || INCLUDE_SHELL || INCLUDE_SHELL_PRESETS

######## end of automatically selected configurations #########	
```

## c/sw_packages/management/PRINTF/Kconfig
```kconfig
#
	
# can be used for release compilations
config DISABLE_DBG_PRINTS
	bool   "disable debug prints"
	depends on INCLUDE_PRINTF
	default n

config USE_MINIMAL_PRINTF
	bool   "use only minimal capabilities"
	default y

config DBG_BUF_SHIFT
	int   "debug buffer size : size = 1 << (2 + DBG_BUF_SHIFT)"
	depends on !DISABLE_DBG_PRINTS && !USE_MINIMAL_PRINTF
	default 8

config PRINTF_MAX_STRING_SIZE
	int   "max size of output string of printf() function"
	depends on !USE_MINIMAL_PRINTF
	default 32
```

## c/sw_packages/management/shell/Kconfig
```kconfig
#
	
config  SHELL_MAX_QUEUE_LEN
	int   "internal queue length"
	default 3

config  SHELL_USE_RUNTIME_CONFIGURATION
	bool   "use runtime configuration for shell"
	default n
```

## c/sw_packages/management/shell_frontend/Kconfig
```kconfig
#

config  SHELL_FRONTEND_MAX_QUEUE_LEN
	int   "internal queue length"
	default 3

config  SHELL_FRONTEND_MAX_BINARY_MESSAGE_LEN
	int   "max_binary message length"
	default 128
```

## c/sw_packages/management/shell_presets/Kconfig
```kconfig
#
	
config  SHELL_PRESETS_NUMBER_OF_PRESET
	int   "number of presets"
	default 4
```

## c/sw_packages/management/u_boot_shell/Kconfig
```kconfig
config INCLUDE_ONLY_UBOOT_SHELL_API
	bool   "include only uboot shell api"
	default n
	---help---
		If you dont want to compile the sources but only use API such as
		uboot command macros.
		If now you are creating the library, implementation should exist in
		other library or in base application.
		If now you are creating application, implementation should exist in
		some library.

config SYS_MAXARGS
	int   "maximal number of arguments"
	depends on !INCLUDE_ONLY_UBOOT_SHELL_API
	default 8

menu "common uboot shell commands"

config UBOOT_CMD_GET_VERSION
	bool   "get version"
	depends on INCLUDE_VERSION_MENAGMENT
	default y

config UBOOT_CMD_GET_SERIAL
	bool   "get serial"
	depends on INCLUDE_SERIAL_NUMBER
	default n
	
config UBOOT_CMD_HEAP_TEST
	bool   "heap test"
	default n
	
config UBOOT_CMD_BOARD_IP
	bool   "board ip"
	depends on INCLUDE_ESP8266
	default n
	
config UBOOT_CMD_BOARD_NAME
	bool   "board name"
	default n
	
config UBOOT_CMD_GET_DEV_PARAM
	bool   "get device parameter"
	depends on INCLUDE_DEV_MENAGMENT
	default n
	
config UBOOT_CMD_SET_DEV_PARAM
	bool   "save device parameter"
	depends on INCLUDE_DEV_MENAGMENT
	default n
	
config UBOOT_CMD_PRINTF_DEV
	bool   "manage printf devices"
	depends on INCLUDE_PRINTF
	default n	
	
config UBOOT_CMD_SPI_FORMAT
	bool   "spi flash format"
	depends on INCLUDE_SPI_FLASH_PARTITION_MANAGER
	default n		
							
endmenu

config UBOOT_GIT_COMMIT_HASH
	string "uboot git commit hash"
	default ""
```

## c/sw_packages/net/Kconfig
```kconfig
#

menu "net"

menuconfig INCLUDE_CURL
	bool   "curl"
	default n
if INCLUDE_CURL
source "$CURL_GIT_DIR/Kconfig"
endif

menuconfig INCLUDE_OPENSSL
	bool   "OpenSSL"
	default n
if INCLUDE_OPENSSL
source "$OPENSSL_GIT_DIR/Kconfig"
endif

menuconfig INCLUDE_WOLFSSL
	bool   "wolfSSL"
	default n
if INCLUDE_WOLFSSL
source "$WOLFSSL_GIT_DIR/Kconfig"
endif

menuconfig INCLUDE_NGHTTP2
	bool   "nghttp2"
	default n
if INCLUDE_NGHTTP2
source "$NGHTTP2_GIT_DIR/Kconfig"
endif


config  USE_INTERNAL_STD_NET_FUNCTION_IMPLEMENTATION
	bool   "use internal standard net function implementation"
	default n


endmenu
```
